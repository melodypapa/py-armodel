AUTOSAR XML (schema 4-0-3)
package /BswMMode/DataTypeMappingSets
  data type mapping set BswMModeMapping: mode-request-type-map{implementation-data-type=uint8, mode-group=BswMModeGroup}
package /BswMMode/ModeDeclarationGroups
  mode declaration group BswMModeGroup: initial-mode=EB_INTGR_BSWM_STARTUP_TWO_A
    7 x mode:
      EB_INTGR_BSWM_GO_OFF_ONE_A
      EB_INTGR_BSWM_GO_OFF_ONE_B
      EB_INTGR_BSWM_PRP_SHUTDOWN
      EB_INTGR_BSWM_RUN_TWO
      EB_INTGR_BSWM_STARTUP_TWO_A
      EB_INTGR_BSWM_STARTUP_TWO_B
      EB_INTGR_BSWM_WAKEUP_TWO
package /BswMMode/PortInterfaces
  mode switch interface BswMMode: is-service=true
    mode group CurrentMode: type=BswMModeGroup
