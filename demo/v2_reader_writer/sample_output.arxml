AUTOSAR XML (schema 3-2-3)
package /TestPackage
  application software component type TestComponent: category=APPLICATION
