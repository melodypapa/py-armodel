AUTOSAR XML (schema 3.2.3)
package /MyComponents
  application software component type MyComponent: category=APPLICATION
