AUTOSAR XML (schema 00046)
package /Os
  module config Os: implementation-config-variant=VARIANT-PRE-COMPILE
    CommonPublishedInformation: ArMajorVersion=5, ArMinorVersion=0, ArPatchVersion=0, ModuleId=0, Release=, SwMajorVersion=6, SwMinorVersion=1, SwPatchVersion=54, VendorId=1
    AlarmIncrementRteCounter (OsAlarm): OsAlarmCounterRef=HwCounter
      OsAlarmAction
        OsAlarmAction (OsAlarmIncrementCounter): OsAlarmIncrementCounterRef=Rte_Counter
      OsAlarmAutostart: OsAlarmAlarmTime=1, OsAlarmAutostartType=RELATIVE, OsAlarmCycleTime=1, OsAlarmAppModeRef=OSDEFAULTAPPMODE
    OSDEFAULTAPPMODE (OsAppMode)
    OsApplication_QM (OsApplication):
      OsTrusted = 0
      OsAppAlarmRef = AlarmIncrementRteCounter
      OsAppCounterRef = HwCounter
      OsAppCounterRef = Rte_Counter
      OsAppTaskRef = Init_Task
      OsAppTaskRef = Rte_Event_Task
      OsAppTaskRef = Rte_Time_Task
      OsAppTaskRef = SchMDiagStateTask_20ms
      OsApplicationHooks: OsAppErrorHook=0, OsAppShutdownHook=0, OsAppStartupHook=0
    HwCounter (OsCounter):
      OsCounterMaxAllowedValue = 4294967295
      OsCounterMinCycle = 1
      OsCounterTicksPerBase = 1
      OsCounterType = HARDWARE
      OsCounterWindowsTimer = TIMER0
      OsSecondsPerTick = 0.01
      OsWindowsIrqLevel = 1
    Rte_Counter (OsCounter): OsCounterMaxAllowedValue=4294967295, OsCounterMinCycle=1, OsCounterTicksPerBase=1, OsCounterType=SOFTWARE, OsSecondsPerTick=0.001
    3 x OsEvent:
      Rte_OSShutdownEvent
      Rte_OSTriggerExecutableEvent_Rte_Event_Task_DRE_523E8C37B43C9473DFA14A98BC1F65F2
      Rte_OSTriggerExecutableEvent_Rte_Event_Task_MSE_4FF9241E67DF8B0AADC83685D425BB32
    OsOS:
      OsExtra_Runtime_Checks = 0
      OsGenerateSWCD = 0
      OsMaxNumberOfCores = 4
      OsMicrocontroller = WIN32X86
      OsNumberOfCores = 1
      OsProtection = OFF
      OsServiceTrace = 0
      OsSourceOptimization = 0
      OsStackMonitoring = 0
      OsStackOptimization = NO
      OsStartupChecks = 0
      OsStatus = EXTENDED
      OsTimestampTimer = INTERNAL
      OsTrace = 0
      OsTracebuffer = 0
      OsUseGetServiceId = 0
      OsUseLastError = 0
      OsUseLogicalCoreIDs = 0
      OsUseParameterAccess = 0
      OsUseResScheduler = 1
      OsWindowsTimeWarpFactor = 1
      OsHooks: OsErrorHook=1, OsPostISRHook=0, OsPostTaskHook=0, OsPreISRHook=0, OsPreTaskHook=0, OsProtectionHook=1, OsShutdownHook=1, OsStartupHook=0
    4 x OsTask, all with OsTaskActivation=1, OsTaskAccessingApplication=OsApplication_QM:
      Init_Task: OsStacksize=1024, OsTaskPriority=127, OsTaskSchedule=NON
        OsTaskAutostart: OsTaskAppModeRef=OSDEFAULTAPPMODE
      Rte_Event_Task: OsStacksize=1024, OsTaskPriority=51, OsTaskSchedule=FULL, OsTaskEventRef=Rte_OSShutdownEvent, OsTaskEventRef=Rte_OSTriggerExecutableEvent_Rte_Event_Task_DRE_523E8C37B43C9473DFA14A98BC1F65F2, OsTaskEventRef=Rte_OSTriggerExecutableEvent_Rte_Event_Task_MSE_4FF9241E67DF8B0AADC83685D425BB32
      Rte_Time_Task: OsStacksize=1024, OsTaskPriority=52, OsTaskSchedule=FULL
      SchMDiagStateTask_20ms: OsStacksize=512, OsTaskPriority=50, OsTaskSchedule=FULL
    PublishedInformation: PbcfgMSupport=0
