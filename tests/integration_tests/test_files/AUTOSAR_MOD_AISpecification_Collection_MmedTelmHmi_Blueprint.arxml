AUTOSAR XML (schema 00050)
package /AUTOSAR/AISpecification/Collections_Blueprint
  collection MmedTelmHmiRefAll:
    category=SET
    auto-collect=REF-ALL
    element-role=PART_OF_SUBSET
    element=[TankFlapHmi, BackliteWinHmi, LidReFromHmiInt, LidReFromHmiExt, GlvBoxHmi, EmgyLockg, TintgAutReq, PanAdjAutOfDrvrSeat, PanAdjAutOfSeatRowFirstMid, PanAdjAutOfPassSeat, PanAdjAutOfSeatRowSecLe, PanAdjAutOfSeatRowSecMid, PanAdjAutOfSeatRowSecRi, PanAdjAutOfSeatRowThrdLe, PanAdjAutOfSeatRowThrdMid, PanAdjAutOfSeatRowThrdRi, AcsOfSeatReByDrvrSeat, AcsOfSeatReBySeatRowFirstMid, AcsOfSeatReByPassSeat, AcsOfSeatReBySeatRowSecLe, AcsOfSeatReBySeatRowSecMid, AcsOfSeatReBySeatRowSecRi, AcsOfSeatReBySeatRowThrdLe, AcsOfSeatReBySeatRowThrdMid, AcsOfSeatReBySeatRowThrdRi, PanAdjManOfDrvrSeat, PanAdjManOfSeatRowFirstMid, PanAdjManOfPassSeat, PanAdjManOfSeatRowSecLe, PanAdjManOfSeatRowSecMid, PanAdjManOfSeatRowSecRi, PanAdjManOfSeatRowThrdLe, PanAdjManOfSeatRowThrdMid, PanAdjManOfSeatRowThrdRi, MassgAdjOfDrvrSeat, MassgAdjOfSeatRowFirstMid, MassgAdjOfPassSeat, MassgAdjOfSeatRowSecLe, MassgAdjOfSeatRowSecMid, MassgAdjOfSeatRowSecRi, MassgAdjOfSeatRowThrdLe, MassgAdjOfSeatRowThrdMid, MassgAdjOfSeatRowThrdRi, MirrMovmtManFromHmi, MirrAdjAutToStoreProf0FromHmi, MirrAdjAutToRestoreProf0FromHmi, MirrAdjAutToStoreProf1FromHmi, MirrAdjAutToRestoreProf1FromHmi, MirrAdjAutToStoreProf2FromHmi, MirrAdjAutToRestoreProf2FromHmi, MirrAdjAutToStoreProf3FromHmi, MirrAdjAutToRestoreProf3FromHmi, DshbBri, NightPanActv, ActvtWipgAutFromHmi, WshngFrntFromHmi, WipgFrntFromHmi, HdlampWshngFromHmi, WipgSpdIntlFromHmi, WshngReFromHmi, WipgReFromHmi, WiprPosnReqFromHmi, HtlModSt, TintgAutSt, MassgStOfDrvrSeat, MassgStOfSeatRowFirstMid, MassgStOfPassSeat, MassgStOfSeatRowSecLe, MassgStOfSeatRowSecMid, MassgStOfSeatRowSecRi, MassgStOfSeatRowThrdLe, MassgStOfSeatRowThrdMid, MassgStOfSeatRowThrdRi, SteerTqSuppsnBascSt, SteerAgSuppsnBascSt, WhlSteerReBascSt, ActvSuspSt, SwilSprgSt, DamprSt, StabrSt, BodyLvlMod, ActrBodyLvlSt, BodyLvlCtrl, DispRainSnsrActv, BtnSimple, BtnMplSt4, BtnMplSt8, BtnMplSt256, TogSt, OutpMplSt4, OutpMplSt8, OutpMplSt256, KnobRotyBndlsStep7, KnobRotyBndlsStep15, SprgCtrlTunActvReq, DispBltLockAck, DispBltLockReq, DispBltLockStOfDrvr, DispBltLockStOfRowFirstMid, DispBltLockStOfPass, DispBltLockStOfRowSecLe, DispBltLockStOfRowSecMid, DispBltLockStOfRowSecRi, DispBltLockStOfRowThrdLe, DispBltLockStOfRowThrdMid, DispBltLockStOfRowThrdRi, SeatBltRmnAcoustWarnReq, DispBucdStOfDrvr, DispBucdStOfOccptAtRowFirstMid, DispBucdStOfPass, DispBucdStOfOccptAtRowSecLe, DispBucdStOfOccptAtRowSecMid, DispBucdStOfOccptAtRowSecRi, DispBucdStOfOccptAtRowThrdLe, DispBucdStOfOccptAtRowThrdMid, DispBucdStOfOccptAtRowThrdRi, SeatBltRmnOpticWarnReq, SetSpdInc, SetSpdDec, VehSpdDispd, AccVehDetdIndcn, CrsCtrlCtrlActv, AccCtrlActv, CrsCtrlActv, AccActv, TirePMonRstReq, TirePThdPerAxle, TirePMonAcptOfWhlNewReq, MonrPReqForTirePMon, MonrPTarReqForTirePMon, TirePMonSt, TirePMonWarnIndcn, TirePMonWarnIndcnPerWhl, TirePMonRstAckd, TirePMonCalStIndcnPerWhl, TirePMonIndcnOfWhlNewRcnd, WhlSpdWarnIndcn, TirePMeasdPerWhl, TireTMeasdPerWhl, TirePThdPerAxleIndcn, SeatBltRmnLdnCtrlAcoustWarn, SeatBltRmnFrqCtrlAcoustWarn, CrsCtrlAndAccSetTiGapInc, CrsCtrlAndAccSetTiGapDec, CrsCtrlAndAccSwtStEngd, SetSpdIndcn]
  collection MmedTelmHmi:
    category=SET
    auto-collect=REF-NONE
    element-role=PART_OF_SUBSET
    element=[AccActv, AccCtrlActv, AccCtrlActv1, AccVehDetd1, AccVehDetdIndcn, AcsOfSeatReByDrvrSeat, AcsOfSeatReByPassSeat, AcsOfSeatReBySeatRowFirstMid, AcsOfSeatReBySeatRowSecLe, AcsOfSeatReBySeatRowSecMid, AcsOfSeatReBySeatRowSecRi, AcsOfSeatReBySeatRowThrdLe, AcsOfSeatReBySeatRowThrdMid, AcsOfSeatReBySeatRowThrdRi, ActrBodyLvlSt, ActrBodyLvlSt1, ActvSuspSt, ActvSuspSt1, ActvtWipgAutFromHmi, ActvtWipgAutReq1, BackliteWinHmi, BodyLvlCtrl, BodyLvlCtrl1, BodyLvlMod, BodyLvlMod1, BriReq1, BtnMplSt256, BtnMplSt256, BtnMplSt4, BtnMplSt4, BtnMplSt8, BtnMplSt8, BtnSimple, BtnSimple1, CrsCtrlActv, CrsCtrlActv1, CrsCtrlAndAccSetTiGapDec, CrsCtrlAndAccSetTiGapInc, CrsCtrlAndAccSwtStEngd, CrsCtrlAndAccSwtStEngd1, CrsCtrlCtrlActv, CrsCtrlCtrlActv1, DamprSt, DamprSt1, DispBltLockAck, DispBltLockAck1, DispBltLockReq, DispBltLockReq1, DispBltLockSt1, DispBltLockStOfDrvr, DispBltLockStOfPass, DispBltLockStOfRowFirstMid, DispBltLockStOfRowSecLe, DispBltLockStOfRowSecMid, DispBltLockStOfRowSecRi, DispBltLockStOfRowThrdLe, DispBltLockStOfRowThrdMid, DispBltLockStOfRowThrdRi, DispBucdStOfDrvr, DispBucdStOfOccpt1, DispBucdStOfOccptAtRowFirstMid, DispBucdStOfOccptAtRowSecLe, DispBucdStOfOccptAtRowSecMid, DispBucdStOfOccptAtRowSecRi, DispBucdStOfOccptAtRowThrdLe, DispBucdStOfOccptAtRowThrdMid, DispBucdStOfOccptAtRowThrdRi, DispBucdStOfPass, DispRainSnsr1, DispRainSnsrActv, DshbBri, EmgyLockg, EntryReq1, GlvBoxHmi, HdlampWshngFromHmi, HtlModSt, HtlModSt1, KnobRotyBndlsStep15, KnobRotyBndlsStep15, KnobRotyBndlsStep7, KnobRotyBndlsStep7, LidReFromHmiExt, LidReFromHmiInt, LockUnlckReq1, LtchRelsReq1, MassgAdjOfDrvrSeat, MassgAdjOfPassSeat, MassgAdjOfSeatRowFirstMid, MassgAdjOfSeatRowSecLe, MassgAdjOfSeatRowSecMid, MassgAdjOfSeatRowSecRi, MassgAdjOfSeatRowThrdLe, MassgAdjOfSeatRowThrdMid, MassgAdjOfSeatRowThrdRi, MassgAdjReq1, MassgAdjSt1, MassgStOfDrvrSeat, MassgStOfPassSeat, MassgStOfSeatRowFirstMid, MassgStOfSeatRowSecLe, MassgStOfSeatRowSecMid, MassgStOfSeatRowSecRi, MassgStOfSeatRowThrdLe, MassgStOfSeatRowThrdMid, MassgStOfSeatRowThrdRi, MirrAdjAutToRestoreProf0FromHmi, MirrAdjAutToRestoreProf1FromHmi, MirrAdjAutToRestoreProf2FromHmi, MirrAdjAutToRestoreProf3FromHmi, MirrAdjAutToStoreProf0FromHmi, MirrAdjAutToStoreProf1FromHmi, MirrAdjAutToStoreProf2FromHmi, MirrAdjAutToStoreProf3FromHmi, MirrMovmtManFromHmi, MirrPanAdjAutReq1, MonrPReqForTirePMon, MonrPReqForTirePMon1, MonrPTarReqForTirePMon, MonrPTarReqForTirePMon1, NightPanActv, NightPanReq1, OutpMplSt256, OutpMplSt256, OutpMplSt4, OutpMplSt4, OutpMplSt8, OutpMplSt8, PanAdjAutOfDrvrSeat, PanAdjAutOfPassSeat, PanAdjAutOfSeatRowFirstMid, PanAdjAutOfSeatRowSecLe, PanAdjAutOfSeatRowSecMid, PanAdjAutOfSeatRowSecRi, PanAdjAutOfSeatRowThrdLe, PanAdjAutOfSeatRowThrdMid, PanAdjAutOfSeatRowThrdRi, PanAdjManOfDrvrSeat, PanAdjManOfPassSeat, PanAdjManOfSeatRowFirstMid, PanAdjManOfSeatRowSecLe, PanAdjManOfSeatRowSecMid, PanAdjManOfSeatRowSecRi, PanAdjManOfSeatRowThrdLe, PanAdjManOfSeatRowThrdMid, PanAdjManOfSeatRowThrdRi, PanAdjmtManReq1, SeatAdjAut1, SeatAdjMan1, SeatBltRmnAcoustWarnReq, SeatBltRmnAcoustWarnReq1, SeatBltRmnFrqCtrlAcoustWarn, SeatBltRmnFrqCtrlAcoustWarn1, SeatBltRmnLdnCtrlAcoustWarn, SeatBltRmnLdnCtrlAcoustWarn1, SeatBltRmnOpticWarnReq, SeatBltRmnOpticWarnReq1, SetSpdDec, SetSpdDec1, SetSpdInc, SetSpdInc1, SetSpdIndcn, SetSpdIndcn1, SprgCtrlTunActvReq, SprgCtrlTunActvReq1, StabrSt, StabrSt1, SteerAgSuppsnBascSt, SteerSt1, SteerTqSuppsnBascSt, SwilSprgSt, SwilSprgSt1, TankFlapHmi, TiGapDec1, TiGapInc1, TintgAutReq, TintgAutReq1, TintgAutSt, TintgAutSt1, TirePMeasdPerWhl, TirePMeasdPerWhl1, TirePMonAcptOfWhlNewReq, TirePMonAcptOfWhlNewReq1, TirePMonCalStIndcnPerWhl, TirePMonCalStIndcnPerWhl1, TirePMonIndcnOfWhlNewRcnd, TirePMonIndcnOfWhlNewRcnd1, TirePMonRstAckd, TirePMonRstAckd1, TirePMonRstReq, TirePMonRstReq1, TirePMonSt, TirePMonSt1, TirePMonWarnIndcn, TirePMonWarnIndcn1, TirePMonWarnIndcnPerWhl, TirePMonWarnIndcnPerWhl1, TirePThdPerAxle, TirePThdPerAxle1, TirePThdPerAxleIndcn, TireTMeasdPerWhl, TireTMeasdPerWhl1, TogReq1, TogSt, TogSt1, VehSpdDispd, VehSpdDispd1, WhlSpdWarnIndcn, WhlSpdWarnIndcn1, WhlSteerReBascSt, WipgFrntFromHmi, WipgReFromHmi, WipgReq1, WipgSpdIntlFromHmi, WipgSpdIntlReq1, WiprPosnCmd1, WiprPosnReqFromHmi, WshngFrntFromHmi, WshngReFromHmi, WshngReq1]
  collection MmedTelmHmiRefAllToMmedTelmHmi: category=RELATION, element-role=AUTO_COLLECTED_FROM, element=MmedTelmHmi, source-element=MmedTelmHmiRefAll
