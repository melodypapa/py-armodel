AUTOSAR XML
package /Os
  module config Os: definition=/TS_T19D1M6I1R0_AS403/Os
    CommonPublishedInformation: ArMajorVersion=5, ArMinorVersion=0, ArPatchVersion=0, SwMajorVersion=6, SwMinorVersion=1, SwPatchVersion=54, ModuleId=0, VendorId=1, Release=
    PublishedInformation: PbcfgMSupport=false
    OsOS:
      OsNumberOfCores = 1
      OsStackMonitoring = false
      OsStatus = EXTENDED
      OsUseGetServiceId = false
      OsUseParameterAccess = false
      OsUseResScheduler = true
      OsTrace = false
      OsExtra_Runtime_Checks = false
      OsStartupChecks = false
      OsServiceTrace = false
      OsSourceOptimization = false
      OsMicrocontroller = WIN32X86
      OsUseLastError = false
      OsTracebuffer = 0
      OsGenerateSWCD = false
      OsUseLogicalCoreIDs = false
      OsTimestampTimer = INTERNAL
      OsMaxNumberOfCores = 4
      OsProtection = OFF
      OsStackOptimization = NO
      OsWindowsTimeWarpFactor = 1
      OsHooks:
        OsErrorHook = true
        OsPostTaskHook = false
        OsPreTaskHook = false
        OsProtectionHook = true
        OsShutdownHook = true
        OsStartupHook = false
        OsPreISRHook = false
        OsPostISRHook = false
    OSDEFAULTAPPMODE (OsAppMode)
    AlarmSetRteShutdownEvent (OsAlarm): OsAlarmCounterRef=/Os/Os/Rte_Counter
      OsAlarmAction (OsAlarmSetEvent): OsAlarmSetEventTaskRef=/Os/Os/Rte_Event_Task, OsAlarmSetEventRef=/Os/Os/Rte_OSShutdownEvent
    CanIsr (OsIsr): OsIsrCategory=CATEGORY_2, OsIsrPeriod=0.005
      OsIsrTimingProtection: OsIsrExecutionBudget=0.001, OsIsrTimeFrame=0.02
        OsIsrResourceLock: OsIsrResourceLockBudget=0.0005, OsIsrResourceLockResourceRef=/Os/Os/OsStackResource
    OsStackResource (OsResource)
    SystemScheduleTable (OsScheduleTable): OsScheduleTableDuration=10, OsScheduleTableRepeating=true, OsScheduleTableCounterRef=/Os/Os/HwCounter
      OsScheduleTableAutostart: OsScheduleTableAutostartType=RELATIVE, OsScheduleTableStartValue=0, OsScheduleTableAppModeRef=/Os/Os/OSDEFAULTAPPMODE
      OsScheduleTableSync: OsScheduleTblSyncStrategy=IMPLICIT
      ExpiryPoint1 (OsScheduleTableExpiryPoint): OsScheduleTblExpPointOffset=2
        OsScheduleTableTaskActivation: OsScheduleTableActivateTaskRef=/Os/Os/Rte_Time_Task
      ExpiryPoint2 (OsScheduleTableExpiryPoint): OsScheduleTblExpPointOffset=5, OsScheduleTableMaxShorten=1, OsScheduleTableMaxLengthen=1
        OsScheduleTableEventSetting: OsScheduleTableSetEventTaskRef=/Os/Os/Rte_Event_Task, OsScheduleTableSetEventRef=/Os/Os/Rte_OSShutdownEvent
    OsApplication_QM (OsApplication):
      OsTrusted = false
      OsAppAlarmRef = /Os/Os/AlarmIncrementRteCounter
      OsAppCounterRef = /Os/Os/HwCounter
      OsAppCounterRef = /Os/Os/Rte_Counter
      OsAppTaskRef = /Os/Os/Init_Task
      OsAppTaskRef = /Os/Os/Rte_Event_Task
      OsAppTaskRef = /Os/Os/Rte_Time_Task
      OsAppTaskRef = /Os/Os/SchMDiagStateTask_20ms
      OsApplicationHooks: OsAppErrorHook=false, OsAppShutdownHook=false, OsAppStartupHook=false
    Rte_Counter (OsCounter): OsCounterMaxAllowedValue=4294967295, OsCounterMinCycle=1, OsCounterTicksPerBase=1, OsCounterType=SOFTWARE, OsSecondsPerTick=0.001
    HwCounter (OsCounter):
      OsCounterMaxAllowedValue = 4294967295
      OsCounterMinCycle = 1
      OsCounterTicksPerBase = 1
      OsCounterType = HARDWARE
      OsCounterWindowsTimer = TIMER0
      OsSecondsPerTick = 0.01
      OsWindowsIrqLevel = 1
    3 x OsEvent:
      Rte_OSShutdownEvent
      Rte_OSTriggerExecutableEvent_Rte_Event_Task_DRE_523E8C37B43C9473DFA14A98BC1F65F2
      Rte_OSTriggerExecutableEvent_Rte_Event_Task_MSE_4FF9241E67DF8B0AADC83685D425BB32
    AlarmIncrementRteCounter (OsAlarm): OsAlarmCounterRef=/Os/Os/HwCounter
      OsAlarmAction (OsAlarmIncrementCounter): OsAlarmIncrementCounterRef=/Os/Os/Rte_Counter
      OsAlarmAutostart: OsAlarmAlarmTime=1, OsAlarmAutostartType=RELATIVE, OsAlarmCycleTime=1, OsAlarmAppModeRef=/Os/Os/OSDEFAULTAPPMODE
    4 x OsTask, all with OsTaskActivation=1, OsTaskAccessingApplication=/Os/Os/OsApplication_QM:
      Init_Task: OsTaskPriority=127, OsTaskSchedule=NON, OsStacksize=1024
        OsTaskAutostart: OsTaskAppModeRef=/Os/Os/OSDEFAULTAPPMODE
      Rte_Time_Task: OsTaskPriority=52, OsStacksize=1024, OsTaskSchedule=FULL
      Rte_Event_Task: OsTaskPriority=51, OsStacksize=1024, OsTaskSchedule=FULL, OsTaskEventRef=/Os/Os/Rte_OSShutdownEvent, OsTaskEventRef=/Os/Os/Rte_OSTriggerExecutableEvent_Rte_Event_Task_DRE_523E8C37B43C9473DFA14A98BC1F65F2, OsTaskEventRef=/Os/Os/Rte_OSTriggerExecutableEvent_Rte_Event_Task_MSE_4FF9241E67DF8B0AADC83685D425BB32
      SchMDiagStateTask_20ms: OsTaskPriority=50, OsStacksize=512, OsTaskSchedule=FULL
