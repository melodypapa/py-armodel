AUTOSAR XML (schema 4-0-3)
standard types defined: float32, float64, sint16, sint16_least, sint32, sint32_least, sint8, sint8_least, uint16, uint16_least, uint32, uint32_least, uint8, uint8_least, void, boolean
package /AUTOSAR_Platform/CompuMethods
  compu method boolean_Literals: 0=FALSE, 1=TRUE
