AUTOSAR XML (schema 4-2-2)
package /Demo/SystemConstants
  sw systemconst SY_TURBO
package /Demo/Criterions
  post build variant criterion Country: variation-point=short-label=VP_Country
package /Demo/SwComponents
  application sw component type MySWC
    behavior Ib_MySWC: variation-point={short-label=VP1, sw-syscond=defined(/Demo/SystemConstants/SY_TURBO) && /Demo/SystemConstants/SY_TURBO == 0, post-build-variant-condition{matching-criterion=Country, value=1}}
      runnable Run2
