AUTOSAR XML (schema 00047)
package /Vendor
  module config BswM
    BswMGeneral: BswMComMEnabled=1
    BswMConfig_P0 (BswMConfig)
      BswMDataTypeMappingSets: BswMDataTypeMappingSetRef=SetA, BswMDataTypeMappingSetRef=SetB
      BswMModeControl
        RMP_Mode (BswMRteModeRequestPort): BswMRteModeRequestPortInterfaceRef=AppMode.AppVdp, BswMRteModeRequestVariableDataPrototypeSRRef=AppVdp
        AC_RteModeRequest (BswMAction)
          BswMAvailableActions
            Request (BswMRteModeRequest): BswMRteModeRequestPortRef=RMP_Mode, BswMRequestedModeRef=RUN
        AC_Start (BswMAction)
          BswMAvailableActions
            Callout (BswMUserCallout): BswMUserCalloutFunction=P0_Start()
        AL_Startup (BswMActionList): BswMActionListExecution=BSWM_TRIGGER
          AI_Mode (BswMActionListItem): BswMActionListItemIndex=0, BswMActionListItemRef=AC_RteModeRequest
    BswMConfig_P1 (BswMConfig)
      BswMDataTypeMappingSets: BswMDataTypeMappingSetRef=SetA
      BswMModeControl
        AC_Start (BswMAction)
          BswMAvailableActions
            Callout (BswMUserCallout): BswMUserCalloutFunction=P1_Start()
        AL_Startup (BswMActionList): BswMActionListExecution=BSWM_CONDITION
          AI_Start (BswMActionListItem): BswMActionListItemIndex=0, BswMActionListItemRef=BswMModeControl/AC_Start
