AUTOSAR XML (schema 00047)
package /Vendor
  module config BswM
    BswMGeneral: BswMComMEnabled=1, BswMMainFunctionPeriod=0.01, BswMWdgMEnabled=1
      BswMUserIncludeFiles: BswMUserIncludeFile=App.h, BswMUserIncludeFile=Diag.h
    BswMConfig_0 (BswMConfig)
      BswMArbitration
        MRP_ComM_CAN1 (BswMModeRequestPort): BswMRequestProcessing=BSWM_IMMEDIATE
          BswMModeInitValue: BswMBswModeInitValue=COMM_NO_COMMUNICATION
          BswMModeRequestSource
            ComMIndication (BswMComMIndication): BswMVendorFlag=1, BswMComMChannelRef=CAN1
        ERP_ComMReset (BswMEventRequestPort): BswMEventRequestProcessing=BSWM_DEFERRED
          BswMEventRequestSource
            InitiateReset (BswMComMInitiateReset)
        MC_CAN1_FULL (BswMModeCondition): BswMConditionType=BSWM_EQUALS, BswMConditionMode=MRP_ComM_CAN1
          BswMConditionValue
            BswMBswMode: BswMBswRequestedMode=COMM_FULL_COMMUNICATION
        MC_Reset (BswMModeCondition): BswMConditionType=BSWM_EQUALS, BswMConditionMode=ERP_ComMReset
        LE_CAN1 (BswMLogicalExpression): BswMLogicalOperator=BSWM_NOT, BswMArgumentRef=MC_CAN1_FULL, BswMArgumentRef=MC_Reset
        LE_Outer (BswMLogicalExpression): BswMLogicalOperator=BSWM_AND, BswMArgumentRef=LE_CAN1
        R_CAN1 (BswMRule): BswMNestedExecutionOnly=0, BswMRuleInitState=BSWM_UNDEFINED, BswMRuleExpressionRef=LE_Outer, BswMRuleTrueActionList=AL_Startup
      BswMModeControl
        SP_AppMode (BswMSwitchPort): BswMModeSwitchInterfaceRef=AppModeIf
        AC_RteSwitch (BswMAction)
          BswMAvailableActions
            Switch (BswMRteSwitch): BswMRteSwitchPortRef=SP_AppMode, BswMSwitchedMode=RUN
        AL_Startup (BswMActionList): BswMActionListExecution=BSWM_TRIGGER
          AI_Switch (BswMActionListItem): BswMActionListItemIndex=10, BswMReportFailRuntimeErrorId=300, BswMActionListItemRef=AC_RteSwitch
          AI_Nested (BswMActionListItem): BswMActionListItemIndex=10, BswMActionListItemRef=R_CAN1
