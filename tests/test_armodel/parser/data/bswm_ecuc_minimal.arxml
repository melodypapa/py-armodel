AUTOSAR XML (schema 00047)
package /Vendor
  module config BswM
    BswMConfig_0 (BswMConfig)
      BswMModeControl
        3 x BswMAction:
          AC_UserCallout
            BswMAvailableActions
              Callout (BswMUserCallout): BswMUserCalloutFunction=App_OnStartup()
          AC_PduGroupSwitch
            BswMAvailableActions
              Switch (BswMPduGroupSwitch):
                BswMPduGroupSwitchReinit = 1
                BswMVendorSwitchEnabled = 1
                BswMVendorOsTaskRef = OsTask_BswM
                BswMEnabledPduGroupRef = IpduGroup_Tx
                BswMEnabledPduGroupRef = IpduGroup_Rx
          AC_VendorOnly
            BswMAvailableActions
              Vendor (BswMVendorAction): BswMVendorFunction=Vendor_Do()
        AL_Startup (BswMActionList): BswMActionListExecution=BSWM_TRIGGER, BswMActionListPriority=5, BswMVendorTraceEnabled=1
          3 x BswMActionListItem:
            AI_PduGroupSwitch: BswMAbortOnFail=0, BswMActionListItemIndex=20, BswMActionListItemRef=AC_PduGroupSwitch
            AI_UserCallout: BswMAbortOnFail=1, BswMActionListItemIndex=10, BswMReportFailRuntimeErrorId=200, BswMActionListItemRef=AC_UserCallout
            AI_Dangling: BswMActionListItemIndex=30, BswMActionListItemRef=AC_Missing
