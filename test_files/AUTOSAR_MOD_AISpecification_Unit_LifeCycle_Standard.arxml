AUTOSAR XML (schema 00050)
package /AUTOSAR/AISpecification/LifeCycleInfoSets
  life cycle info set UnitLifeCycles
    life-cycle-infos:
      lc-object=Ampr, lc-state=valid, period-begin=ar-release-version=4.4.0
      lc-object=AmprPerSec, lc-state=valid, period-begin=ar-release-version=4.4.0
      lc-object=AmprSec, lc-state=valid, period-begin=ar-release-version=4.4.0
      lc-object=Bar, lc-state=valid, period-begin=ar-release-version=4.4.0
      lc-object=BarPerSec, lc-state=valid, period-begin=ar-release-version=4.4.0
      lc-object=Bel, lc-state=valid, period-begin=ar-release-version=4.4.0
      lc-object=Bit, lc-state=valid, period-begin=ar-release-version=4.4.0
      lc-object=BitPerSec, lc-state=valid, period-begin=ar-release-version=4.4.0
      lc-object=Byte, lc-state=valid, period-begin=ar-release-version=4.4.0
      lc-object=BytPerSec, lc-state=valid, period-begin=ar-release-version=4.4.0
      lc-object=Cd, lc-state=valid, period-begin=ar-release-version=4.4.0
      lc-object=CentiMtr, lc-state=valid, period-begin=ar-release-version=4.4.0
      lc-object=CentiMtrSqd, lc-state=valid, period-begin=ar-release-version=4.4.0
      lc-object=Coulomb, lc-state=valid, period-begin=ar-release-version=4.4.0
      lc-object=Day, lc-state=valid, period-begin=ar-release-version=4.4.0
      lc-object=DeciBel, lc-state=valid, period-begin=ar-release-version=4.4.0
      lc-object=Deg, lc-state=valid, period-begin=ar-release-version=4.4.0
      lc-object=DegCgrd, lc-state=valid, period-begin=ar-release-version=4.4.0
      lc-object=DegPerSec, lc-state=valid, period-begin=ar-release-version=4.4.0
      lc-object=Frd, lc-state=valid, period-begin=ar-release-version=4.4.0
      lc-object=Gr, lc-state=valid, period-begin=ar-release-version=4.4.0
      lc-object=GrPerLtr, lc-state=valid, period-begin=ar-release-version=4.4.0
      lc-object=GrPerMol, lc-state=valid, period-begin=ar-release-version=4.4.0
      lc-object=GrPerSec, lc-state=valid, period-begin=ar-release-version=4.4.0
      lc-object=HectoPa, lc-state=valid, period-begin=ar-release-version=4.4.0
      lc-object=HectoPaPerSec, lc-state=valid, period-begin=ar-release-version=4.4.0
      lc-object=HectoPaPerVolt, lc-state=valid, period-begin=ar-release-version=4.4.0
      lc-object=HectoPaSecPerMtrCubd, lc-state=valid, period-begin=ar-release-version=4.4.0
      lc-object=Henry, lc-state=valid, period-begin=ar-release-version=4.4.0
      lc-object=HenryPerMtr, lc-state=valid, period-begin=ar-release-version=4.4.0
      lc-object=Hr, lc-state=valid, period-begin=ar-release-version=4.4.0
      lc-object=Hz, lc-state=valid, period-begin=ar-release-version=4.4.0
      lc-object=Jou, lc-state=valid, period-begin=ar-release-version=4.4.0
      lc-object=JouPerKelvin, lc-state=valid, period-begin=ar-release-version=4.4.0
      lc-object=JouPerKiloGr, lc-state=valid, period-begin=ar-release-version=4.4.0
      lc-object=JouPerKiloGrPerKelvin, lc-state=valid, period-begin=ar-release-version=4.4.0
      lc-object=JouPerMol, lc-state=valid, period-begin=ar-release-version=4.4.0
      lc-object=JouPerMolPerKelvin, lc-state=valid, period-begin=ar-release-version=4.4.0
      lc-object=Kat, lc-state=valid, period-begin=ar-release-version=4.4.0
      lc-object=KelvinAbslt, lc-state=valid, period-begin=ar-release-version=4.4.0
      lc-object=KelvinPerSec, lc-state=valid, period-begin=ar-release-version=4.4.0
      lc-object=KelvinRel, lc-state=valid, period-begin=ar-release-version=4.4.0
      lc-object=KiloBitPerSec, lc-state=valid, period-begin=ar-release-version=4.4.0
      lc-object=KiloGr, lc-state=valid, period-begin=ar-release-version=4.4.0
      lc-object=KiloGrPerHr, lc-state=valid, period-begin=ar-release-version=4.4.0
      lc-object=KiloGrPerMtrCubd, lc-state=valid, period-begin=ar-release-version=4.4.0
      lc-object=KiloGrPerSec, lc-state=valid, period-begin=ar-release-version=4.4.0
      lc-object=KiloGrSqrMtr, lc-state=valid, period-begin=ar-release-version=4.4.0
      lc-object=KiloHz, lc-state=valid, period-begin=ar-release-version=4.4.0
      lc-object=KiloJou, lc-state=valid, period-begin=ar-release-version=4.4.0
      lc-object=KiloMtr, lc-state=valid, period-begin=ar-release-version=4.4.0
      lc-object=KiloMtrPerHr, lc-state=valid, period-begin=ar-release-version=4.4.0
      lc-object=KiloMtrPerHrPerSec, lc-state=valid, period-begin=ar-release-version=4.4.0
      lc-object=KiloNwt, lc-state=valid, period-begin=ar-release-version=4.4.0
      lc-object=KiloNwtMtrPerSec, lc-state=valid, period-begin=ar-release-version=4.4.0
      lc-object=KiloOhm, lc-state=valid, period-begin=ar-release-version=4.4.0
      lc-object=KiloVolt, lc-state=valid, period-begin=ar-release-version=4.4.0
      lc-object=KiloWatt, lc-state=valid, period-begin=ar-release-version=4.4.0
      lc-object=KiloWattHr, lc-state=valid, period-begin=ar-release-version=4.4.0
      lc-object=KiloWattHrPer100KiloMtr, lc-state=valid, period-begin=ar-release-version=4.4.0
      lc-object=Ltr, lc-state=valid, period-begin=ar-release-version=4.4.0
      lc-object=LtrPer100KiloMtr, lc-state=valid, period-begin=ar-release-version=4.4.0
      lc-object=LtrPerHr, lc-state=valid, period-begin=ar-release-version=4.4.0
      lc-object=LtrPerKiloMtr, lc-state=valid, period-begin=ar-release-version=4.4.0
      lc-object=MegaBitPerSec, lc-state=valid, period-begin=ar-release-version=4.4.0
      lc-object=MegaHz, lc-state=valid, period-begin=ar-release-version=4.4.0
      lc-object=MegaJou, lc-state=valid, period-begin=ar-release-version=4.4.0
      lc-object=MegaOhm, lc-state=valid, period-begin=ar-release-version=4.4.0
      lc-object=MegaPa, lc-state=valid, period-begin=ar-release-version=4.4.0
      lc-object=MegaWatt, lc-state=valid, period-begin=ar-release-version=4.4.0
      lc-object=MicroAmpr, lc-state=valid, period-begin=ar-release-version=4.4.0
      lc-object=MicroFrd, lc-state=valid, period-begin=ar-release-version=4.4.0
      lc-object=MicroGr, lc-state=valid, period-begin=ar-release-version=4.4.0
      lc-object=MicroJou, lc-state=valid, period-begin=ar-release-version=4.4.0
      lc-object=MicroLtr, lc-state=valid, period-begin=ar-release-version=4.4.0
      lc-object=MicroLtrPerSec, lc-state=valid, period-begin=ar-release-version=4.4.0
      lc-object=MicroMtr, lc-state=valid, period-begin=ar-release-version=4.4.0
      lc-object=MicroSec, lc-state=valid, period-begin=ar-release-version=4.4.0
      lc-object=MicroTesla, lc-state=valid, period-begin=ar-release-version=4.4.0
      lc-object=MilliAmpr, lc-state=valid, period-begin=ar-release-version=4.4.0
      lc-object=MilliAmprPerSec, lc-state=valid, period-begin=ar-release-version=4.4.0
      lc-object=MilliBar, lc-state=valid, period-begin=ar-release-version=4.4.0
      lc-object=MilliFrd, lc-state=valid, period-begin=ar-release-version=4.4.0
      lc-object=MilliGr, lc-state=valid, period-begin=ar-release-version=4.4.0
      lc-object=MilliGrPerSec, lc-state=valid, period-begin=ar-release-version=4.4.0
      lc-object=MilliJou, lc-state=valid, period-begin=ar-release-version=4.4.0
      lc-object=MilliLtr, lc-state=valid, period-begin=ar-release-version=4.4.0
      lc-object=MilliMtr, lc-state=valid, period-begin=ar-release-version=4.4.0
      lc-object=MilliMtrCubd, lc-state=valid, period-begin=ar-release-version=4.4.0
      lc-object=MilliMtrCubdPerSec, lc-state=valid, period-begin=ar-release-version=4.4.0
      lc-object=MilliOhm, lc-state=valid, period-begin=ar-release-version=4.4.0
      lc-object=MilliSec, lc-state=valid, period-begin=ar-release-version=4.4.0
      lc-object=MilliTesla, lc-state=valid, period-begin=ar-release-version=4.4.0
      lc-object=MilliVolt, lc-state=valid, period-begin=ar-release-version=4.4.0
      lc-object=MilliVoltPerSec, lc-state=valid, period-begin=ar-release-version=4.4.0
      lc-object=MilliWatt, lc-state=valid, period-begin=ar-release-version=4.4.0
      lc-object=Mins, lc-state=valid, period-begin=ar-release-version=4.4.0
      lc-object=Ml, lc-state=valid, period-begin=ar-release-version=4.4.0
      lc-object=MlPerHr, lc-state=valid, period-begin=ar-release-version=4.4.0
      lc-object=Mol, lc-state=valid, period-begin=ar-release-version=4.4.0
      lc-object=MolPerLtr, lc-state=valid, period-begin=ar-release-version=4.4.0
      lc-object=MolPerLtrPerSec, lc-state=valid, period-begin=ar-release-version=4.4.0
      lc-object=MolPerMtrCubd, lc-state=valid, period-begin=ar-release-version=4.4.0
      lc-object=MolPerSec, lc-state=valid, period-begin=ar-release-version=4.4.0
      lc-object=Mtr, lc-state=valid, period-begin=ar-release-version=4.4.0
      lc-object=MtrCubd, lc-state=valid, period-begin=ar-release-version=4.4.0
      lc-object=MtrCubdPerHr, lc-state=valid, period-begin=ar-release-version=4.4.0
      lc-object=MtrCubdPerHrPerSec, lc-state=valid, period-begin=ar-release-version=4.4.0
      lc-object=MtrCubdPerKiloGr, lc-state=valid, period-begin=ar-release-version=4.4.0
      lc-object=MtrPerSec, lc-state=valid, period-begin=ar-release-version=4.4.0
      lc-object=MtrPerSecCubd, lc-state=valid, period-begin=ar-release-version=4.4.0
      lc-object=MtrPerSecSqd, lc-state=valid, period-begin=ar-release-version=4.4.0
      lc-object=MtrSqd, lc-state=valid, period-begin=ar-release-version=4.4.0
      lc-object=MtrSqdPerSec, lc-state=valid, period-begin=ar-release-version=4.4.0
      lc-object=NanoFrd, lc-state=valid, period-begin=ar-release-version=4.4.0
      lc-object=NanoSec, lc-state=valid, period-begin=ar-release-version=4.4.0
      lc-object=NoUnit, lc-state=valid, period-begin=ar-release-version=4.4.0
      lc-object=Nwt, lc-state=valid, period-begin=ar-release-version=4.4.0
      lc-object=NwtMtr, lc-state=valid, period-begin=ar-release-version=4.4.0
      lc-object=NwtMtrPerRpm, lc-state=valid, period-begin=ar-release-version=4.4.0
      lc-object=NwtMtrPerRpmPerSec, lc-state=valid, period-begin=ar-release-version=4.4.0
      lc-object=NwtMtrPerSec, lc-state=valid, period-begin=ar-release-version=4.4.0
      lc-object=NwtMtrSec, lc-state=valid, period-begin=ar-release-version=4.4.0
      lc-object=NwtMtrSqrSec, lc-state=valid, period-begin=ar-release-version=4.4.0
      lc-object=NwtPerMtr, lc-state=valid, period-begin=ar-release-version=4.4.0
      lc-object=NwtSecPerMtr, lc-state=valid, period-begin=ar-release-version=4.4.0
      lc-object=Ohm, lc-state=valid, period-begin=ar-release-version=4.4.0
      lc-object=Pa, lc-state=valid, period-begin=ar-release-version=4.4.0
      lc-object=PaPerMtrCubdPerSec, lc-state=valid, period-begin=ar-release-version=4.4.0
      lc-object=PaPerSec, lc-state=valid, period-begin=ar-release-version=4.4.0
      lc-object=PaSec, lc-state=valid, period-begin=ar-release-version=4.4.0
      lc-object=Perc, lc-state=valid, period-begin=ar-release-version=4.4.0
      lc-object=PercPerMilliSec, lc-state=valid, period-begin=ar-release-version=4.4.0
      lc-object=PercPerSec, lc-state=valid, period-begin=ar-release-version=4.4.0
      lc-object=PerMille, lc-state=valid, period-begin=ar-release-version=4.4.0
      lc-object=PerMin, lc-state=valid, period-begin=ar-release-version=4.4.0
      lc-object=PerMtr, lc-state=valid, period-begin=ar-release-version=4.4.0
      lc-object=PerSec, lc-state=valid, period-begin=ar-release-version=4.4.0
      lc-object=PerSecSqd, lc-state=valid, period-begin=ar-release-version=4.4.0
      lc-object=PicoFrd, lc-state=valid, period-begin=ar-release-version=4.4.0
      lc-object=PicoSec, lc-state=valid, period-begin=ar-release-version=4.4.0
      lc-object=Ppm, lc-state=valid, period-begin=ar-release-version=4.4.0
      lc-object=Rad, lc-state=valid, period-begin=ar-release-version=4.4.0
      lc-object=RadPerSec, lc-state=valid, period-begin=ar-release-version=4.4.0
      lc-object=RadPerSecSqd, lc-state=valid, period-begin=ar-release-version=4.4.0
      lc-object=Rpm, lc-state=valid, period-begin=ar-release-version=4.4.0
      lc-object=RpmPerSec, lc-state=valid, period-begin=ar-release-version=4.4.0
      lc-object=S, lc-state=valid, period-begin=ar-release-version=4.4.0
      lc-object=Sec, lc-state=valid, period-begin=ar-release-version=4.4.0
      lc-object=SPerMtr, lc-state=valid, period-begin=ar-release-version=4.4.0
      lc-object=SPerMtrPerSec, lc-state=valid, period-begin=ar-release-version=4.4.0
      lc-object=Tesla, lc-state=valid, period-begin=ar-release-version=4.4.0
      lc-object=Tonne, lc-state=valid, period-begin=ar-release-version=4.4.0
      lc-object=Volt, lc-state=valid, period-begin=ar-release-version=4.4.0
      lc-object=VoltPerMilliSec, lc-state=valid, period-begin=ar-release-version=4.4.0
      lc-object=VoltPerMtr, lc-state=valid, period-begin=ar-release-version=4.4.0
      lc-object=VoltPerSec, lc-state=valid, period-begin=ar-release-version=4.4.0
      lc-object=Watt, lc-state=valid, period-begin=ar-release-version=4.4.0
      lc-object=WattPerKelvinPerMtrSqd, lc-state=valid, period-begin=ar-release-version=4.4.0
      lc-object=WattPerMtrPerKelvin, lc-state=valid, period-begin=ar-release-version=4.4.0
      lc-object=WattPerSec, lc-state=valid, period-begin=ar-release-version=4.4.0
      lc-object=WattSec, lc-state=valid, period-begin=ar-release-version=4.4.0
      lc-object=Wb, lc-state=valid, period-begin=ar-release-version=4.4.0
      lc-object=Yr, lc-state=valid, period-begin=ar-release-version=4.4.0
      lc-object=Bar, lc-state=obsolete, period-begin=ar-release-version=4.4.0, use-instead=Bar
      lc-object=DegCgrd, lc-state=obsolete, period-begin=ar-release-version=4.4.0, use-instead=DegCgrd
      lc-object=HectoPa, lc-state=obsolete, period-begin=ar-release-version=4.4.0, use-instead=HectoPa
      lc-object=Hz, lc-state=obsolete, period-begin=ar-release-version=4.4.0, use-instead=Hz
      lc-object=Kelvin, lc-state=obsolete, period-begin=ar-release-version=4.4.0
      lc-object=KelvinRel, lc-state=obsolete, period-begin=ar-release-version=4.4.0, use-instead=KelvinRel
      lc-object=KiloGr, lc-state=obsolete, period-begin=ar-release-version=4.4.0, use-instead=KiloGr
      lc-object=KiloHz, lc-state=obsolete, period-begin=ar-release-version=4.4.0, use-instead=KiloHz
      lc-object=KiloMtr, lc-state=obsolete, period-begin=ar-release-version=4.4.0, use-instead=KiloMtr
      lc-object=Mtr, lc-state=obsolete, period-begin=ar-release-version=4.4.0, use-instead=Mtr
      lc-object=MtrPerSec, lc-state=obsolete, period-begin=ar-release-version=4.4.0, use-instead=MtrPerSec
      lc-object=MtrPerSecCubd, lc-state=obsolete, period-begin=ar-release-version=4.4.0, use-instead=MtrPerSecCubd
      lc-object=MtrPerSecSqd, lc-state=obsolete, period-begin=ar-release-version=4.4.0, use-instead=MtrPerSecSqd
      lc-object=MtrRecpr, lc-state=obsolete, period-begin=ar-release-version=4.4.0
      lc-object=NoUnit, lc-state=obsolete, period-begin=ar-release-version=4.4.0, use-instead=NoUnit
      lc-object=Nwt, lc-state=obsolete, period-begin=ar-release-version=4.4.0, use-instead=Nwt
      lc-object=NwtMtr, lc-state=obsolete, period-begin=ar-release-version=4.4.0, use-instead=NwtMtr
      lc-object=NwtMtrPerSec, lc-state=obsolete, period-begin=ar-release-version=4.4.0, use-instead=NwtMtrPerSec
      lc-object=NwtPerMtr, lc-state=obsolete, period-begin=ar-release-version=4.4.0, use-instead=NwtPerMtr
      lc-object=NwtSecPerMtr, lc-state=obsolete, period-begin=ar-release-version=4.4.0, use-instead=NwtSecPerMtr
      lc-object=Pa, lc-state=obsolete, period-begin=ar-release-version=4.4.0, use-instead=Pa
      lc-object=Perc, lc-state=obsolete, period-begin=ar-release-version=4.4.0, use-instead=Perc
      lc-object=PercPerSec, lc-state=obsolete, period-begin=ar-release-version=4.4.0, use-instead=PercPerSec
      lc-object=Rad, lc-state=obsolete, period-begin=ar-release-version=4.4.0, use-instead=Rad
      lc-object=RadPerSec, lc-state=obsolete, period-begin=ar-release-version=4.4.0, use-instead=RadPerSec
      lc-object=RadPerSecSqd, lc-state=obsolete, period-begin=ar-release-version=4.4.0, use-instead=RadPerSecSqd
      lc-object=Rpm, lc-state=obsolete, period-begin=ar-release-version=4.4.0, use-instead=Rpm
      lc-object=RpmPerSec, lc-state=obsolete, period-begin=ar-release-version=4.4.0, use-instead=RpmPerSec
      lc-object=Sec, lc-state=obsolete, period-begin=ar-release-version=4.4.0, use-instead=Sec
      lc-object=Volt, lc-state=obsolete, period-begin=ar-release-version=4.4.0, use-instead=Volt
      lc-object=NwtMtrSec, lc-state=valid, period-begin=ar-release-version=4.5.0, remark=p=l-1=Correction of Longname
