AUTOSAR XML (schema 00050)
standard types defined: SInt8
