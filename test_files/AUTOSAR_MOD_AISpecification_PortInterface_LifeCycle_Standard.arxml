AUTOSAR XML (schema 00050)
package /AUTOSAR/AISpecification/LifeCycleInfoSets
  life cycle info set PortIfObslt: default-lc-state=obsolete, used-life-cycle-state-definition-group=AutosarLifeCycleStates
    life-cycle-infos:
      lc-object=TrsmTqDftlAxleFrntAct1, lc-state=obsolete, period-begin=ar-release-version=4.2.1, remark=p=l-1=Interface short name changed, keyword Act replaced by Consold, use-instead=TrsmTqDftlAxleFrntConsold1
      lc-object=TrsmTqDftlAxleReAct1, lc-state=obsolete, period-begin=ar-release-version=4.2.1, remark=p=l-1=Interface short name changed, keyword Act replaced by Consold, use-instead=TrsmTqDftlAxleReConsold1
      lc-object=TrsmTqDftlTrfAct1, lc-state=obsolete, period-begin=ar-release-version=4.2.1, remark=p=l-1=Interface short name changed, keyword Act replaced by Consold, use-instead=TrsmTqDftlTrfConsold1
      lc-object=TrsmRatGearAct1, lc-state=obsolete, period-begin=ar-release-version=4.2.1, remark=p=l-1=Interface short name changed, keyword Act replaced by Consold, use-instead=TrsmRatGearConsold1
      lc-object=TrsmCluStAct1, lc-state=obsolete, period-begin=ar-release-version=4.2.1, remark=p=l-1=Interface short name changed, keyword Act replaced by Consold, use-instead=TrsmCluStConsold1
      lc-object=TrsmNrGearAct1, lc-state=obsolete, period-begin=ar-release-version=4.2.1, remark=p=l-1=Interface short name changed, keyword Act replaced by Consold, use-instead=TrsmNrGearConsold1
      lc-object=TrsmRatTqPtAct1, lc-state=obsolete, period-begin=ar-release-version=4.2.1, remark=p=l-1=Interface short name changed, keyword Act replaced by Consold, use-instead=TrsmRatTqPtConsold1
      lc-object=ActrBodyLvlSts1, lc-state=obsolete, period-begin=ar-release-version=4.2.1, remark=p=l-1=Change of shortname, use-instead=ActrBodyLvlSt1
      lc-object=ActvSuspSts1, lc-state=obsolete, period-begin=ar-release-version=4.2.1, remark=p=l-1=Change of shortname, use-instead=ActvSuspSt1
      lc-object=AlrmSts1, lc-state=obsolete, period-begin=ar-release-version=4.2.1, remark=p=l-1=Change of shortname, use-instead=AlrmSt1
      lc-object=AntithftPasSts1, lc-state=obsolete, period-begin=ar-release-version=4.2.1, remark=p=l-1=Change of shortname, use-instead=AntithftPasSt1
      lc-object=CarHeiSts1, lc-state=obsolete, period-begin=ar-release-version=4.2.1, remark=p=l-1=Change of shortname, use-instead=CarHeiSt1
      lc-object=ChdProtnSts1, lc-state=obsolete, period-begin=ar-release-version=4.2.1, remark=p=l-1=Change of shortname, use-instead=ChdProtnSt1
      lc-object=CrashSts1, lc-state=obsolete, period-begin=ar-release-version=4.2.1, remark=p=l-1=Change of shortname, use-instead=CrashSt1
      lc-object=CrsCtrlAndAccSwtStsEngd1, lc-state=obsolete, period-begin=ar-release-version=4.2.1, remark=p=l-1=Change of shortname, use-instead=CrsCtrlAndAccSwtStEngd1
      lc-object=DamprSts1, lc-state=obsolete, period-begin=ar-release-version=4.2.1, remark=p=l-1=Change of shortname, use-instead=DamprSt1
      lc-object=DefrstSts1, lc-state=obsolete, period-begin=ar-release-version=4.2.1, remark=p=l-1=Change of shortname, use-instead=DefrstSt1
      lc-object=DftlCoorrSts1, period-begin=ar-release-version=4.2.1, remark=p=l-1=Change of shortname, use-instead=DftlCoorrSt1
      lc-object=DoorHndlSenSts1, period-begin=ar-release-version=4.2.1, remark=p=l-1=Change of shortname, use-instead=DoorHndlSenSt1
      lc-object=DoorHndlSts1, period-begin=ar-release-version=4.2.1, remark=p=l-1=Change of shortname, use-instead=DoorHndlSt1
      lc-object=DoorSts1, period-begin=ar-release-version=4.2.1, remark=p=l-1=Change of shortname, use-instead=DoorSt1
      lc-object=DtTqDistbnStsIndcn1, period-begin=ar-release-version=4.2.1, remark=p=l-1=Change of shortname, use-instead=DtTqDistbnStIndcn1
      lc-object=EgyMngtSts1, period-begin=ar-release-version=4.2.1, remark=p=l-1=Change of shortname, use-instead=EgyMngtSt1
      lc-object=EngHoodSts1, period-begin=ar-release-version=4.2.1, remark=p=l-1=Change of shortname, use-instead=EngHoodSt1
      lc-object=EpbActrFltSts1, period-begin=ar-release-version=4.2.1, remark=p=l-1=Change of shortname, use-instead=EpbActrFltSt1
      lc-object=EpbBtnCtrlSts1, period-begin=ar-release-version=4.2.1, remark=p=l-1=Change of shortname, use-instead=EpbBtnCtrlSt1
      lc-object=EscSts1, period-begin=ar-release-version=4.2.1, remark=p=l-1=Change of shortname, use-instead=EscSt1
      lc-object=EscStsIndcn1, period-begin=ar-release-version=4.2.1, remark=p=l-1=Change of shortname, use-instead=EscStIndcn1
      lc-object=FltStsOfSeatClima1, period-begin=ar-release-version=4.2.1, remark=p=l-1=Change of shortname, use-instead=FltStOfSeatClima1
      lc-object=HldOnDmdSts1, period-begin=ar-release-version=4.2.1, remark=p=l-1=Change of shortname, use-instead=HldOnDmdSt1
      lc-object=HoopRollSts1, period-begin=ar-release-version=4.2.1, remark=p=l-1=Change of shortname, use-instead=HoopRollSt1
      lc-object=HornSts1, period-begin=ar-release-version=4.2.1, remark=p=l-1=Change of shortname, use-instead=HornSt1
      lc-object=HtlModSts1, period-begin=ar-release-version=4.2.1, remark=p=l-1=Change of shortname, use-instead=HtlModSt1
      lc-object=IdCfmdSts1, period-begin=ar-release-version=4.2.1, remark=p=l-1=Change of shortname, use-instead=IdCfmdSt1
      lc-object=ImobSts1, period-begin=ar-release-version=4.2.1, remark=p=l-1=Change of shortname, use-instead=ImobSt1
      lc-object=InclnSts1, period-begin=ar-release-version=4.2.1, remark=p=l-1=Change of shortname, use-instead=InclnSt1
      lc-object=KeyInsertSts1, period-begin=ar-release-version=4.2.1, remark=p=l-1=Change of shortname, use-instead=KeyInsertSt1
      lc-object=LiFltSts1, period-begin=ar-release-version=4.2.1, remark=p=l-1=Change of shortname, use-instead=LiFltSt1
      lc-object=LockSts1, period-begin=ar-release-version=4.2.1, remark=p=l-1=Change of shortname, use-instead=LockSt1
      lc-object=LockStsOfSteerCol1, period-begin=ar-release-version=4.2.1, remark=p=l-1=Change of shortname, use-instead=LockStOfSteerCol1
      lc-object=LockgCenSts1, period-begin=ar-release-version=4.2.1, remark=p=l-1=Change of shortname, use-instead=LockgCenSt1
      lc-object=LvlDefrstSts1, period-begin=ar-release-version=4.2.1, remark=p=l-1=Change of shortname, use-instead=LvlDefrstSt1
      lc-object=MassgAdjSts1, period-begin=ar-release-version=4.2.1, remark=p=l-1=Change of shortname, use-instead=MassgAdjSt1
      lc-object=MirrActnSts1, period-begin=ar-release-version=4.2.1, remark=p=l-1=Change of shortname, use-instead=MirrActnSt1
      lc-object=MirrFltSts1, period-begin=ar-release-version=4.2.1, remark=p=l-1=Change of shortname, use-instead=MirrFltSt1
      lc-object=MirrMoveSts1, period-begin=ar-release-version=4.2.1, remark=p=l-1=Change of shortname, use-instead=MirrMoveSt1
      lc-object=MirrPosnSts1, period-begin=ar-release-version=4.2.1, remark=p=l-1=Change of shortname, use-instead=MirrPosnSt1
      lc-object=MirrTintgSts1, period-begin=ar-release-version=4.2.1, remark=p=l-1=Change of shortname, use-instead=MirrTintgSt1
      lc-object=NozHeatrSts1, period-begin=ar-release-version=4.2.1, remark=p=l-1=Change of shortname, use-instead=NozHeatrSt1
      lc-object=OpendClsdSts1, period-begin=ar-release-version=4.2.1, remark=p=l-1=Change of shortname, use-instead=OpendClsdSt1
      lc-object=OperModSts1, period-begin=ar-release-version=4.2.1, remark=p=l-1=Change of shortname, use-instead=OperModSt1
      lc-object=OutdBriSts1, period-begin=ar-release-version=4.2.1, remark=p=l-1=Change of shortname, use-instead=OutdBriSt1
      lc-object=PanicAlrmSts1, period-begin=ar-release-version=4.2.1, remark=p=l-1=Change of shortname, use-instead=PanicAlrmSt1
      lc-object=PaseActvnSts1, period-begin=ar-release-version=4.2.1, remark=p=l-1=Change of shortname, use-instead=PaseActvnSt1
      lc-object=PaseKeylsInvldSts1, period-begin=ar-release-version=4.2.1, remark=p=l-1=Change of shortname, use-instead=PaseKeylsInvldSt1
      lc-object=PosnSts1, period-begin=ar-release-version=4.2.1, remark=p=l-1=Change of shortname, use-instead=PosnSt1
      lc-object=ProfPenSts1, period-begin=ar-release-version=4.2.1, remark=p=l-1=Change of shortname, use-instead=ProfPenSt1
      lc-object=PwrSplySts1, period-begin=ar-release-version=4.2.1, remark=p=l-1=Change of shortname, use-instead=PwrSplySt1
      lc-object=RadioSts1, period-begin=ar-release-version=4.2.1, remark=p=l-1=Change of shortname, use-instead=RadioSt1
      lc-object=RainAmntSts1, period-begin=ar-release-version=4.2.1, remark=p=l-1=Change of shortname, use-instead=RainAmntSt1
      lc-object=RoadCdnSts1, period-begin=ar-release-version=4.2.1, remark=p=l-1=Change of shortname, use-instead=RoadCdnSt1
      lc-object=RoofCnvtbSts1, period-begin=ar-release-version=4.2.1, remark=p=l-1=Change of shortname, use-instead=RoofCnvtbSt1
      lc-object=SeatAxisPosnSts1, period-begin=ar-release-version=4.2.1, remark=p=l-1=Change of shortname, use-instead=SeatAxisPosnSt1
      lc-object=SeatFixaSts1, period-begin=ar-release-version=4.2.1, remark=p=l-1=Change of shortname, use-instead=SeatFixaSt1
      lc-object=SeatMoveSts1, period-begin=ar-release-version=4.2.1, remark=p=l-1=Change of shortname, use-instead=SeatMoveSt1
      lc-object=SeatStorePosnSts1, period-begin=ar-release-version=4.2.1, remark=p=l-1=Change of shortname, use-instead=SeatStorePosnSt1
      lc-object=SnsrAlrmSimpleSts1, period-begin=ar-release-version=4.2.1, remark=p=l-1=Change of shortname, use-instead=SnsrAlrmSimpleSt1
      lc-object=SnsrAlrmSts1, period-begin=ar-release-version=4.2.1, remark=p=l-1=Change of shortname, use-instead=SnsrAlrmSt1
      lc-object=SnsrGlassBreakSts1, period-begin=ar-release-version=4.2.1, remark=p=l-1=Change of shortname, use-instead=SnsrGlassBreakSt1
      lc-object=SnsrInclnSts1, period-begin=ar-release-version=4.2.1, remark=p=l-1=Change of shortname, use-instead=SnsrInclnSt1
      lc-object=SnsrIntrScanrSts1, period-begin=ar-release-version=4.2.1, remark=p=l-1=Change of shortname, use-instead=SnsrIntrScanrSt1
      lc-object=SnsrRoofCnvtbSts1, period-begin=ar-release-version=4.2.1, remark=p=l-1=Change of shortname, use-instead=SnsrRoofCnvtbSt1
      lc-object=SnsrSoundrBattBackedSts1, period-begin=ar-release-version=4.2.1, remark=p=l-1=Change of shortname, use-instead=SnsrSoundrBattBackedSt1
      lc-object=SsmSts1, period-begin=ar-release-version=4.2.1, remark=p=l-1=Change of shortname, use-instead=SsmSt1
      lc-object=StabrSts1, period-begin=ar-release-version=4.2.1, remark=p=l-1=Change of shortname, use-instead=StabrSt1
      lc-object=SteerDrvrAsscSysStsIndcn1, period-begin=ar-release-version=4.2.1, remark=p=l-1=Change of shortname, use-instead=SteerDrvrAsscSysStIndcn1
      lc-object=SteerSts1, period-begin=ar-release-version=4.2.1, remark=p=l-1=Change of shortname, use-instead=SteerSt1
      lc-object=SteerTqSuppsnFrntSts1, period-begin=ar-release-version=4.2.1, remark=p=l-1=Change of shortname, use-instead=SteerTqSuppsnFrntSt1
      lc-object=SwilSprgSts1, period-begin=ar-release-version=4.2.1, remark=p=l-1=Change of shortname, use-instead=SwilSprgSt1
      lc-object=SwtStrtSts1, period-begin=ar-release-version=4.2.1, remark=p=l-1=Change of shortname, use-instead=SwtStrtSt1
      lc-object=TerminalPosnSts1, period-begin=ar-release-version=4.2.1, remark=p=l-1=Change of shortname, use-instead=TerminalPosnSt1
      lc-object=TintgAutSts1, period-begin=ar-release-version=4.2.1, remark=p=l-1=Change of shortname, use-instead=TintgAutSt1
      lc-object=TirePMonCalStsIndcnPerWhl1, period-begin=ar-release-version=4.2.1, remark=p=l-1=Change of shortname, use-instead=TirePMonCalStIndcnPerWhl1
      lc-object=TirePMonSts1, period-begin=ar-release-version=4.2.1, remark=p=l-1=Change of shortname, use-instead=TirePMonSt1
      lc-object=TrlrHitchSts1, period-begin=ar-release-version=4.2.1, remark=p=l-1=Change of shortname, use-instead=TrlrHitchSt1
      lc-object=TrlrSts1, period-begin=ar-release-version=4.2.1, remark=p=l-1=Change of shortname, use-instead=TrlrSt1
      lc-object=VehHldSts1, period-begin=ar-release-version=4.2.1, remark=p=l-1=Change of shortname, use-instead=VehHldSt1
      lc-object=WinHeatrSts1, period-begin=ar-release-version=4.2.1, remark=p=l-1=Change of shortname, use-instead=WinHeatrSt1
      lc-object=WiprSts1, period-begin=ar-release-version=4.2.1, remark=p=l-1=Change of shortname, use-instead=WiprSt1
      lc-object=WshrFldSts1, period-begin=ar-release-version=4.2.1, remark=p=l-1=Change of shortname, use-instead=WshrFldSt1
      lc-object=WshrSts1, period-begin=ar-release-version=4.2.1, remark=p=l-1=Change of shortname, use-instead=WshrSt1
      lc-object=ACenForOccptPedSfty1, period-begin=ar-release-version=4.1.1, remark=p=l-1=changed data type specification, use-instead=ACenForOccptPedSfty2
      lc-object=AExtForOccptPedSfty1, period-begin=ar-release-version=4.1.1, remark=p=l-1=changed data type specification, use-instead=AExtForOccptPedSfty2
      lc-object=CogPosnEstimd1, period-begin=ar-release-version=4.1.1, remark=p=l-1=Interface Name Harmonization (removal of "Estimd"), use-instead=CogPosn1
      lc-object=DamprCoeffEstimd1, period-begin=ar-release-version=4.1.1, remark=p=l-1=Interface Name Harmonization (removal of "Estimd"), use-instead=DamprCoeff1
      lc-object=DamprFEstimd1, period-begin=ar-release-version=4.1.1, remark=p=l-1=Interface Name Harmonization (removal of "Estimd"), use-instead=DamprF1
      lc-object=FricCoeffEstimd1, period-begin=ar-release-version=4.1.1, remark=p=l-1=Interface Name Harmonization (removal of "Estimd"), use-instead=FricCoeff1
      lc-object=SnsrInclInhbReq1, period-begin=ar-release-version=4.1.1, remark=p=l-1=Correction of used keyword abbreviation, use-instead=SnsrInclnInhbReq1
      lc-object=SprgCoeffEstimd1, period-begin=ar-release-version=4.1.1, remark=p=l-1=Interface Name Harmonization (removal of "Estimd"), use-instead=SprgCoeff1
      lc-object=SprgFEstimd1, period-begin=ar-release-version=4.1.1, remark=p=l-1=Interface Name Harmonization (removal of "Estimd"), use-instead=SprgF1
      lc-object=TirePEstimdPerWhl1, period-begin=ar-release-version=4.1.1, remark=p=l-1=Interface Name Harmonization (removal of "Estimd"), use-instead=TirePPerWhl1
      lc-object=TireTEstimdPerWhl1, period-begin=ar-release-version=4.1.1, remark=p=l-1=Interface Name Harmonization (removal of "Estimd"), use-instead=TireTPerWhl1
      lc-object=VehMEstimd1, period-begin=ar-release-version=4.1.1, remark=p=l-1=Interface Name Harmonization (removal of "Estimd"), use-instead=VehM1
      lc-object=HvacTqReq1, lc-state=obsolete, period-begin=ar-release-version=4.2.1, use-instead=AcTqReq1
      lc-object=PtFlgHvacDeactvt1, lc-state=obsolete, period-begin=ar-release-version=4.2.1, use-instead=PtFlgAcDeactvt1
      lc-object=PtTqMaxHvac1, lc-state=obsolete, period-begin=ar-release-version=4.2.1, use-instead=PtTqMaxAc1
      lc-object=HvacTq1, lc-state=obsolete, period-begin=ar-release-version=4.2.1, use-instead=AcTq1
      lc-object=EmTqDynJ1, lc-state=valid, period-begin=ar-release-version=4.2.1
      lc-object=EngTqCrksftMaxSpdCur1, lc-state=valid, period-begin=ar-release-version=4.2.1
      lc-object=EngTqCluMin1, lc-state=obsolete, period-begin=ar-release-version=4.3.1, use-instead=EngTqCrksftRedByAncllryLossMin1
      lc-object=AccrPedlMeasd1, lc-state=valid, period-begin=ar-release-version=4.3.0
      lc-object=AccrPedlMeasd1, lc-state=valid, period-begin=ar-release-version=4.3.0
      lc-object=PtAccrPedlPosn1, lc-state=valid, period-begin=ar-release-version=4.3.1
      lc-object=AccrPedlGrdt1, lc-state=valid, period-begin=ar-release-version=4.3.0
      lc-object=AccrPedlGrdt1, lc-state=valid, period-begin=ar-release-version=4.3.0
      lc-object=AccrPedlRat1, lc-state=obsolete, period-begin=ar-release-version=4.3.0, use-instead=AccrPedlMeasd1
      lc-object=AccrPedlRatFild1, lc-state=obsolete, period-begin=ar-release-version=4.3.0, use-instead=PtAccrPedlPosn1
      lc-object=AccrPedlRatGrdt1, lc-state=obsolete, period-begin=ar-release-version=4.3.0, use-instead=AccrPedlGrdt1
      lc-object=AccrPedl1, lc-state=valid, period-begin=ar-release-version=4.3.0
      lc-object=TrsmTqCluResvReq1, lc-state=valid, period-begin=ar-release-version=4.3.1
      lc-object=TrsmTqCluStandStillPred1, lc-state=valid, period-begin=ar-release-version=4.3.1
      lc-object=TrsmTqCluMinProtnReq1, lc-state=valid, period-begin=ar-release-version=4.3.1
      lc-object=TrsmTqCluLoss1, lc-state=valid, period-begin=ar-release-version=4.3.1
      lc-object=EngTqResvReqPt1, lc-state=valid, period-begin=ar-release-version=4.3.0
      lc-object=EngTqResvReqPt1, lc-state=valid, period-begin=ar-release-version=4.3.0
      lc-object=EngTqResvPt1, lc-state=obsolete, period-begin=ar-release-version=4.3.0, use-instead=EngTqResvReqPt1
      lc-object=PtFlgAcDeactvtReq1, lc-state=valid, period-begin=ar-release-version=4.3.0
      lc-object=PtFlgAcDeactvt1, lc-state=obsolete, period-begin=ar-release-version=4.3.0, use-instead=PtFlgAcDeactvtReq1
      lc-object=PtFlgAltDeactvtReq1, lc-state=valid, period-begin=ar-release-version=4.3.0
      lc-object=PtFlgAltDeactvt1, lc-state=obsolete, period-begin=ar-release-version=4.3.0, use-instead=PtFlgAltDeactvtReq1
      lc-object=PtTqResvReqEng1, lc-state=valid, period-begin=ar-release-version=4.3.0
      lc-object=PtTqResvEng1, lc-state=obsolete, period-begin=ar-release-version=4.3.0, use-instead=PtTqResvReqEng1
      lc-object=TrsmFlgSptModReq1, lc-state=valid, period-begin=ar-release-version=4.3.0
      lc-object=TrsmFlgSptMod1, lc-state=obsolete, period-begin=ar-release-version=4.3.0, use-instead=TrsmFlgSptModReq1
      lc-object=TrsmFlgWntrModReq1, lc-state=valid, period-begin=ar-release-version=4.3.0
      lc-object=TrsmFlgWntrMod1, lc-state=obsolete, period-begin=ar-release-version=4.3.0, use-instead=TrsmFlgWntrModReq1
      lc-object=TrsmRatTqWhlByTqCluTar1, lc-state=valid, period-begin=ar-release-version=4.3.1
      lc-object=TrsmRatTqWhlByTqClu1, lc-state=valid, period-begin=ar-release-version=4.3.1
      lc-object=TrsmCluNReq1, lc-state=valid, period-begin=ar-release-version=4.3.1
      lc-object=TrsmCluNReqEnaReq1, lc-state=valid, period-begin=ar-release-version=4.3.1
      lc-object=TrsmGbxCoreSt1, lc-state=valid, period-begin=ar-release-version=4.4.0
      lc-object=GbxCoreSt1, lc-state=valid, period-begin=ar-release-version=4.3.1
      lc-object=TrsmDrvOffElmSt1, lc-state=valid, period-begin=ar-release-version=4.4.0
      lc-object=DrvOffElmSt1, lc-state=valid, period-begin=ar-release-version=4.3.1
      lc-object=TrsmRatTqTrsmOutpByTqClu1, lc-state=valid, period-begin=ar-release-version=4.3.1
      lc-object=TrsmRatTqTrsmOutpByTqCluTar1, lc-state=valid, period-begin=ar-release-version=4.3.1
      lc-object=PtGearLvrLockReq1, lc-state=valid, period-begin=ar-release-version=4.4.0
      lc-object=TrsmCluNLimnReq1, lc-state=valid, period-begin=ar-release-version=4.3.1
      lc-object=PtCluN1, lc-state=valid, period-begin=ar-release-version=4.4.0
      lc-object=TrsmGearSt1, lc-state=valid, period-begin=ar-release-version=4.4.0
      lc-object=TrsmGbxSt1, lc-state=valid, period-begin=ar-release-version=4.4.0
      lc-object=GbxSt1, lc-state=valid, period-begin=ar-release-version=4.3.1
      lc-object=TrsmRednGbxSt1, lc-state=valid, period-begin=ar-release-version=4.4.0
      lc-object=RednGbxSt1, lc-state=valid, period-begin=ar-release-version=4.3.1
      lc-object=TrsmDrvOffElmStTar1, lc-state=valid, period-begin=ar-release-version=4.4.0
      lc-object=DrvOffElmStTar1, lc-state=valid, period-begin=ar-release-version=4.3.1
      lc-object=TrsmInpN1, lc-state=valid, period-begin=ar-release-version=4.4.0
      lc-object=TrsmTqCluMaxProtnReq1, lc-state=valid, period-begin=ar-release-version=4.4.0
      lc-object=EngTqCrksftMaxSpdCur1, lc-state=obsolete, period-begin=ar-release-version=4.3.1
      lc-object=PtNEngSp1, lc-state=obsolete, period-begin=ar-release-version=4.3.0
      lc-object=TrsmNInp1, lc-state=obsolete, period-begin=ar-release-version=4.3.0, use-instead=TrsmInpN1
      lc-object=PtNClu1, lc-state=obsolete, period-begin=ar-release-version=4.3.0, use-instead=PtCluN1
      lc-object=EngTqCrksftRedByAncllryLossMin1, lc-state=valid, period-begin=ar-release-version=4.4.0
      lc-object=EngTqCrksftRedByAncllryLoss1, lc-state=valid, period-begin=ar-release-version=4.4.0
      lc-object=PtKdDetd1, lc-state=valid, period-begin=ar-release-version=4.3.1
      lc-object=PtTqCrksftRedByAncllryLossReq1, lc-state=valid, period-begin=ar-release-version=4.4.0
      lc-object=PtEmTqReq1, lc-state=valid, period-begin=ar-release-version=4.4.0
      lc-object=PtEmTq1, lc-state=valid, period-begin=ar-release-version=4.4.0
      lc-object=PtEmTqMaxCluNCur1, lc-state=valid, period-begin=ar-release-version=4.4.0
      lc-object=PtEmTqMinCluNCur1, lc-state=valid, period-begin=ar-release-version=4.4.0
      lc-object=PtTqJClu1, lc-state=valid, period-begin=ar-release-version=4.4.0
      lc-object=EngTqJCrksft1, lc-state=valid, period-begin=ar-release-version=4.4.0
      lc-object=PtEmTqJRotorShaft1, lc-state=valid, period-begin=ar-release-version=4.4.0
      lc-object=PtTqCluEngMaxProtnReq1, lc-state=valid, period-begin=ar-release-version=4.4.0
      lc-object=PtEngNInclgStrtStop1, lc-state=valid, period-begin=ar-release-version=4.4.0
      lc-object=PtEngNSpIdle1, lc-state=valid, period-begin=ar-release-version=4.4.0
      lc-object=TrsmTqCluGrdtUpprLimReq1, lc-state=valid, period-begin=ar-release-version=4.4.0
      lc-object=PtCluEngSt1, lc-state=valid, period-begin=ar-release-version=4.4.0
      lc-object=PtEngNReq1, lc-state=valid, period-begin=ar-release-version=4.4.0
      lc-object=PtEngNReqEnaReq1, lc-state=valid, period-begin=ar-release-version=4.4.0
      lc-object=PtCluEngTqMaxCluPCur1, lc-state=valid, period-begin=ar-release-version=4.4.0
      lc-object=PtEmTqResvReq1, lc-state=valid, period-begin=ar-release-version=4.4.0
      lc-object=TrsmRatTqPtConsold1, lc-state=obsolete, period-begin=ar-release-version=4.4.0, use-instead=TrsmRatTqWhlByTqClu1
      lc-object=TrsmNrGearReq1, lc-state=obsolete, period-begin=ar-release-version=4.4.0, use-instead=TrsmGearSt1
      lc-object=TrsmNrGearTar1, lc-state=obsolete, period-begin=ar-release-version=4.4.0, use-instead=TrsmGearSt1
      lc-object=TrsmNrGearConsold1, lc-state=obsolete, period-begin=ar-release-version=4.3.1, use-instead=TrsmGearSt1
      lc-object=EmTqDynJ1, lc-state=obsolete, period-begin=ar-release-version=4.3.1, use-instead=PtEmTqJRotorShaft1
      lc-object=TrsmCluSt1, lc-state=obsolete, period-begin=ar-release-version=4.4.0, use-instead=TrsmDrvOffElmSt1
      lc-object=TrsmCluStTar1, lc-state=obsolete, period-begin=ar-release-version=4.4.0, use-instead=TrsmDrvOffElmStTar1
      lc-object=EngTqCrksftMaxEngNCur, lc-state=valid, period-begin=ar-release-version=4.3.1
      lc-object=PtTqCluReqWoTrsmIntv1, lc-state=valid, period-begin=ar-release-version=4.3.1
      lc-object=PtTqCrksftRedByAncllryLossReq, lc-state=valid, period-begin=ar-release-version=4.4.0
      lc-object=PtEmTqReq, lc-state=valid, period-begin=ar-release-version=4.4.0
      lc-object=PtEmTq, lc-state=valid, period-begin=ar-release-version=4.4.0
      lc-object=PtEmTqMaxCluNCur, lc-state=valid, period-begin=ar-release-version=4.4.0
      lc-object=PtEmTqMinCluNCur, lc-state=valid, period-begin=ar-release-version=4.4.0
      lc-object=PtTqJClu, lc-state=valid, period-begin=ar-release-version=4.5.0
      lc-object=EngTqJCrksft, lc-state=valid, period-begin=ar-release-version=4.3.1
      lc-object=PtEmTqJRotorShaft, lc-state=valid, period-begin=ar-release-version=4.4.0
      lc-object=PtTqClu, lc-state=valid, period-begin=ar-release-version=4.3.1
      lc-object=PtTqClu1, lc-state=valid, period-begin=ar-release-version=4.3.1
      lc-object=EngTqCrksft1, lc-state=valid, period-begin=ar-release-version=4.3.1
      lc-object=EngTqCrksft, lc-state=valid, period-begin=ar-release-version=4.3.1
      lc-object=PtTqCluWoTrsmIntv1, lc-state=valid, period-begin=ar-release-version=4.3.1
      lc-object=PtTqCluWoTrsmIntv, lc-state=valid, period-begin=ar-release-version=4.3.1
      lc-object=PtTqCluReqWoTrsmIntv, lc-state=valid, period-begin=ar-release-version=4.3.1
      lc-object=PtTqCluMaxCluNCurLongTerm1, lc-state=valid, period-begin=ar-release-version=4.5.0
      lc-object=PtTqCluMaxCluNCurLongTerm, lc-state=valid, period-begin=ar-release-version=4.5.0
      lc-object=EngTqCrksftMinFast, lc-state=valid, period-begin=ar-release-version=4.4.0
      lc-object=EngTqCrksftMinFast1, lc-state=valid, period-begin=ar-release-version=4.3.1
      lc-object=PtTqCluMinFast1, lc-state=valid, period-begin=ar-release-version=4.5.0
      lc-object=PtTqCluMinFast, lc-state=valid, period-begin=ar-release-version=4.5.0
      lc-object=EngTqCrksftRedByAncllryLoss, lc-state=valid, period-begin=ar-release-version=4.3.1
      lc-object=EngTqCrksftRedByAncllryLossMin, lc-state=valid, period-begin=ar-release-version=4.3.1
      lc-object=EngTqCrksftMin, lc-state=valid, period-begin=ar-release-version=4.3.1
      lc-object=EngTqCrksftMin1, lc-state=valid, period-begin=ar-release-version=4.3.1
      lc-object=TrsmTqCluMaxFastReqForShiftIntv1, lc-state=valid, period-begin=ar-release-version=4.5.0
      lc-object=TrsmTqCluMaxFastReqForShiftIntv, lc-state=valid, period-begin=ar-release-version=4.5.0
      lc-object=TrsmIntvModReqForTqCluMaxFastReqForShiftIntv1, lc-state=valid, period-begin=ar-release-version=4.5.0
      lc-object=TrsmIntvModReqForTqCluMaxFastReqForShiftIntv, lc-state=valid, period-begin=ar-release-version=4.5.0
      lc-object=TrsmNrTypOfTqCluMaxMinFastSlowReqForShiftIntv1, lc-state=valid, period-begin=ar-release-version=4.5.0
      lc-object=TrsmNrTypOfTqCluMaxMinFastSlowReqForShiftIntv, lc-state=valid, period-begin=ar-release-version=4.5.0
      lc-object=TrsmTqCluMaxSlowReqForShiftIntv1, lc-state=valid, period-begin=ar-release-version=4.5.0
      lc-object=TrsmTqCluMaxSlowReqForShiftIntv, lc-state=valid, period-begin=ar-release-version=4.5.0
      lc-object=TrsmTqCluMinFastReqForShiftIntv1, lc-state=valid, period-begin=ar-release-version=4.5.0
      lc-object=TrsmTqCluMinFastReqForShiftIntv, lc-state=valid, period-begin=ar-release-version=4.5.0
      lc-object=TrsmTqCluMinSlowReqForShiftIntv1, lc-state=valid, period-begin=ar-release-version=4.5.0
      lc-object=TrsmTqCluMinSlowReqForShiftIntv, lc-state=valid, period-begin=ar-release-version=4.5.0
      lc-object=TrsmTqCluReqForShiftIntv1, lc-state=valid, period-begin=ar-release-version=4.5.0
      lc-object=TrsmTqCluReqForShiftIntv, lc-state=valid, period-begin=ar-release-version=4.5.0
      lc-object=TrsmNrTypOfTqCluReqForShiftIntv1, lc-state=valid, period-begin=ar-release-version=4.5.0
      lc-object=TrsmNrTypOfTqCluReqForShiftIntv, lc-state=valid, period-begin=ar-release-version=4.5.0
      lc-object=TrsmIntvModReqForTqCluReqForShiftIntv1, lc-state=valid, period-begin=ar-release-version=4.5.0
      lc-object=TrsmIntvModReqForTqCluReqForShiftIntv, lc-state=valid, period-begin=ar-release-version=4.5.0
      lc-object=PtDrvrReqTqClu1, lc-state=valid, period-begin=ar-release-version=4.5.0
      lc-object=PtDrvrReqTqClu, lc-state=valid, period-begin=ar-release-version=4.5.0
      lc-object=PtDrvrReqTqCluPredEngN1, lc-state=valid, period-begin=ar-release-version=4.5.0
      lc-object=PtDrvrReqTqCluPredEngN, lc-state=valid, period-begin=ar-release-version=4.5.0
      lc-object=TrsmTqCluResvReq, lc-state=valid, period-begin=ar-release-version=4.3.0
      lc-object=TrsmNrTypOfTqCluResvReq1, lc-state=valid, period-begin=ar-release-version=4.5.0
      lc-object=TrsmNrTypOfTqCluResvReq, lc-state=valid, period-begin=ar-release-version=4.5.0
      lc-object=TrsmTiCluNReqTar1, lc-state=valid, period-begin=ar-release-version=4.5.0
      lc-object=TrsmTiCluNReqTar, lc-state=valid, period-begin=ar-release-version=4.5.0
      lc-object=TrsmCluNReqEnaReq, lc-state=valid, period-begin=ar-release-version=4.3.1
      lc-object=TrsmCluNLimnReq, lc-state=valid, period-begin=ar-release-version=4.3.1
      lc-object=PtEngNInclgStrtStop, lc-state=valid, period-begin=ar-release-version=4.3.1
      lc-object=EngRunngDirSt, lc-state=valid, period-begin=ar-release-version=4.3.1
      lc-object=EngRunngDirSt1, lc-state=valid, period-begin=ar-release-version=4.3.1
      lc-object=TrsmCluNPredGearTar1, lc-state=valid, period-begin=ar-release-version=4.5.0
      lc-object=TrsmCluNPredGearTar, lc-state=valid, period-begin=ar-release-version=4.5.0
      lc-object=TrsmCluNMinReq1, lc-state=valid, period-begin=ar-release-version=4.5.0
      lc-object=TrsmCluNMinReq, lc-state=valid, period-begin=ar-release-version=4.5.0
      lc-object=TrsmTqCluGrdtUpprLimReq, lc-state=valid, period-begin=ar-release-version=4.3.1
      lc-object=EngT1, lc-state=valid, period-begin=ar-release-version=4.3.1
      lc-object=EngT, lc-state=valid, period-begin=ar-release-version=4.3.0
      lc-object=TrsmTOil, lc-state=valid, period-begin=ar-release-version=4.3.1
      lc-object=TrsmTOil1, lc-state=valid, period-begin=ar-release-version=4.3.1
      lc-object=AmbAirT1, lc-state=valid, period-begin=ar-release-version=4.3.1
      lc-object=AmbAirT, lc-state=valid, period-begin=ar-release-version=4.3.0
      lc-object=TrsmTqCluStandStillPred, lc-state=valid, period-begin=ar-release-version=4.3.0
      lc-object=TrsmTqCluGbxCnsNIdleCtrlr1, lc-state=valid, period-begin=ar-release-version=4.5.0
      lc-object=TrsmTqCluGbxCnsNIdleCtrlr, lc-state=valid, period-begin=ar-release-version=4.5.0
      lc-object=TrsmGbxCoreSt, lc-state=valid, period-begin=ar-release-version=4.3.1
      lc-object=TrsmDrvOffElmSt, lc-state=valid, period-begin=ar-release-version=4.3.1
      lc-object=TrsmDrvOffElmStTar, lc-state=valid, period-begin=ar-release-version=4.3.1
      lc-object=TrsmGbxSt, lc-state=valid, period-begin=ar-release-version=4.3.1
      lc-object=TrsmRednGbxSt, lc-state=valid, period-begin=ar-release-version=4.3.1
      lc-object=PtCluEngSt, lc-state=valid, period-begin=ar-release-version=4.3.1
      lc-object=PtCluN, lc-state=valid, period-begin=ar-release-version=4.3.0
      lc-object=TrsmRatTqWhlByTqClu, lc-state=valid, period-begin=ar-release-version=4.3.0
      lc-object=TrsmRatTqTrsmOutpByTqClu, lc-state=valid, period-begin=ar-release-version=4.3.0
      lc-object=TrsmRatTqWhlByTqCluTar, lc-state=valid, period-begin=ar-release-version=4.3.0
      lc-object=TrsmRatTqTrsmOutpByTqCluTar, lc-state=valid, period-begin=ar-release-version=4.3.1
      lc-object=TrsmTqCluLoss, lc-state=valid, period-begin=ar-release-version=4.3.0
      lc-object=TrsmTqOilPmp, lc-state=valid, period-begin=ar-release-version=4.3.0
      lc-object=TrsmTqOilPmp1, lc-state=valid, period-begin=ar-release-version=4.3.1
      lc-object=PtEngNReq, lc-state=valid, period-begin=ar-release-version=4.3.1
      lc-object=PtEngNReqEnaReq, lc-state=valid, period-begin=ar-release-version=4.3.1
      lc-object=TrsmGearSt, lc-state=valid, period-begin=ar-release-version=4.3.1
      lc-object=TrsmFlgShiftProgs, lc-state=valid, period-begin=ar-release-version=4.3.0
      lc-object=TrsmFlgShiftProgs1, lc-state=valid, period-begin=ar-release-version=4.3.1
      lc-object=PtAccrPedlPosnVirt, lc-state=valid, period-begin=ar-release-version=4.3.1
      lc-object=PtAccrPedlPosnVirt1, lc-state=valid, period-begin=ar-release-version=4.4.0
      lc-object=PtAccrPedlPosn, lc-state=valid, period-begin=ar-release-version=4.3.1
      lc-object=PtGearLvrLockReq, lc-state=valid, period-begin=ar-release-version=4.3.1
      lc-object=PtCluEngTqMaxCluPCur, lc-state=valid, period-begin=ar-release-version=4.3.1
      lc-object=PtEmTqResvReq, lc-state=valid, period-begin=ar-release-version=4.3.1
      lc-object=PtTqCluMaxCluNCurShoTerm1, lc-state=valid, period-begin=ar-release-version=4.5.0
      lc-object=PtTqCluMaxCluNCurShoTerm, lc-state=valid, period-begin=ar-release-version=4.5.0
      lc-object=PtTqCluMinByIgnRtd1, lc-state=valid, period-begin=ar-release-version=4.5.0
      lc-object=PtTqCluMinByIgnRtd, lc-state=valid, period-begin=ar-release-version=4.5.0
      lc-object=EngTqCluStrtPred1, lc-state=valid, period-begin=ar-release-version=4.5.0
      lc-object=EngTqCluStrtPred, lc-state=valid, period-begin=ar-release-version=4.5.0
      lc-object=PtEmTqRelCluReq1, lc-state=valid, period-begin=ar-release-version=4.5.0
      lc-object=PtEmTqRelCluReq, lc-state=valid, period-begin=ar-release-version=4.5.0
      lc-object=PtNrTypEmTqRelCluReq1, lc-state=valid, period-begin=ar-release-version=4.5.0
      lc-object=PtNrTypEmTqRelCluReq, lc-state=valid, period-begin=ar-release-version=4.5.0
      lc-object=PtEmNIdle1, lc-state=valid, period-begin=ar-release-version=4.5.0
      lc-object=PtEmNIdle, lc-state=valid, period-begin=ar-release-version=4.5.0
      lc-object=PtCluEngStCtrl1, lc-state=valid, period-begin=ar-release-version=4.5.0
      lc-object=PtCluEngStCtrl, lc-state=valid, period-begin=ar-release-version=4.5.0
      lc-object=PtCluEngStCtrlTar1, lc-state=valid, period-begin=ar-release-version=4.5.0
      lc-object=PtCluEngStCtrlTar, lc-state=valid, period-begin=ar-release-version=4.5.0
      lc-object=PtFuCutCoastActv1, lc-state=valid, period-begin=ar-release-version=4.5.0
      lc-object=PtFuCutCoastActv, lc-state=valid, period-begin=ar-release-version=4.5.0
      lc-object=PtCluNLimnLoReq1, lc-state=valid, period-begin=ar-release-version=4.5.0
      lc-object=PtCluNLimnLoReq, lc-state=valid, period-begin=ar-release-version=4.5.0
      lc-object=PtCluNLimnUpReq1, lc-state=valid, period-begin=ar-release-version=4.5.0
      lc-object=PtCluNLimnUpReq, lc-state=valid, period-begin=ar-release-version=4.5.0
      lc-object=TrsmNrTypOfTqCluResvReq, lc-state=valid, period-begin=ar-release-version=4.5.0
      lc-object=TrsmNrTypOfTqCluResvReq1, lc-state=valid, period-begin=ar-release-version=4.5.0
      lc-object=EmTqDynJ, lc-state=obsolete, period-begin=ar-release-version=4.3.1, use-instead=PtEmTqJRotorShaft
      lc-object=EngTqCluMin, lc-state=obsolete, period-begin=ar-release-version=4.3.1, use-instead=EngTqCrksftRedByAncllryLossMin
      lc-object=EngTqCrksftMaxSpdCur, lc-state=obsolete, period-begin=ar-release-version=4.3.1
      lc-object=TrsmTqOilPmp1, lc-state=valid, period-begin=ar-release-version=4.3.1
