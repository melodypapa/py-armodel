AUTOSAR XML (schema 00050)
package /AUTOSAR/AISpecification/LifeCycleInfoSets
  life cycle info set PhysicalDimensionLifeCycles
    life-cycle-infos:
      lc-object=LenNeg4M1TiNeg1, lc-state=valid, period-begin=ar-release-version=4.4.0
      lc-object=LenNeg3MNeg1Ti2I2, lc-state=valid, period-begin=ar-release-version=4.4.0
      lc-object=LenNeg3MNeg1Ti3I2, lc-state=valid, period-begin=ar-release-version=4.4.0
      lc-object=LenNeg3TiNeg1Amnt1, lc-state=valid, period-begin=ar-release-version=4.4.0
      lc-object=LenNeg3Amnt1, lc-state=valid, period-begin=ar-release-version=4.4.0
      lc-object=LenNeg3Ti1I1, lc-state=valid, period-begin=ar-release-version=4.4.0
      lc-object=LenNeg3Ti1I1_1, lc-state=valid, period-begin=ar-release-version=4.4.0
      lc-object=LenNeg3M1, lc-state=valid, period-begin=ar-release-version=4.4.0
      lc-object=LenNeg2MNeg1Ti3I2, lc-state=valid, period-begin=ar-release-version=4.4.0
      lc-object=LenNeg2MNeg1Ti4I2, lc-state=valid, period-begin=ar-release-version=4.4.0
      lc-object=LenNeg2Illmn1, lc-state=valid, period-begin=ar-release-version=4.4.0
      lc-object=LenNeg1, lc-state=valid, period-begin=ar-release-version=4.4.0
      lc-object=LenNeg1M1TiNeg3, lc-state=valid, period-begin=ar-release-version=4.4.0
      lc-object=LenNeg1M1TiNeg2, lc-state=valid, period-begin=ar-release-version=4.4.0
      lc-object=LenNeg1M1TiNeg2_1, lc-state=valid, period-begin=ar-release-version=4.4.0
      lc-object=LenNeg1M1TiNeg1, lc-state=valid, period-begin=ar-release-version=4.4.0
      lc-object=TiNeg2, lc-state=valid, period-begin=ar-release-version=4.4.0
      lc-object=TiNeg1, lc-state=valid, period-begin=ar-release-version=4.4.0
      lc-object=TiNeg1_{1..3}, lc-state=valid, period-begin=ar-release-version=4.4.0
      lc-object=TiNeg1Amnt1, lc-state=valid, period-begin=ar-release-version=4.4.0
      lc-object=TiNeg1T1, lc-state=valid, period-begin=ar-release-version=4.4.0
      lc-object=TiNeg1I1, lc-state=valid, period-begin=ar-release-version=4.4.0
      lc-object=NoDimension, lc-state=valid, period-begin=ar-release-version=4.4.0
      lc-object=NoDimension_1, lc-state=valid, period-begin=ar-release-version=4.4.0
      lc-object=NoDimension_2, lc-state=valid, period-begin=ar-release-version=4.4.0
      lc-object=NoDimension_5, lc-state=valid, period-begin=ar-release-version=4.4.0
      lc-object=NoDimension_6, lc-state=valid, period-begin=ar-release-version=4.4.0
      lc-object=Illmn1, lc-state=valid, period-begin=ar-release-version=4.4.0
      lc-object=Amnt1, lc-state=valid, period-begin=ar-release-version=4.4.0
      lc-object=T1, lc-state=valid, period-begin=ar-release-version=4.4.0
      lc-object=T1_1, lc-state=valid, period-begin=ar-release-version=4.4.0
      lc-object=I1, lc-state=valid, period-begin=ar-release-version=4.4.0
      lc-object=Ti1, lc-state=valid, period-begin=ar-release-version=4.4.0
      lc-object=T1I1, lc-state=valid, period-begin=ar-release-version=4.4.0
      lc-object=M1TiNeg3TNeg1, lc-state=valid, period-begin=ar-release-version=4.4.0
      lc-object=M1TiNeg2INeg1, lc-state=valid, period-begin=ar-release-version=4.4.0
      lc-object=M1TiNeg2, lc-state=valid, period-begin=ar-release-version=4.4.0
      lc-object=M1TiNeg1, lc-state=valid, period-begin=ar-release-version=4.4.0
      lc-object=M1TiNeg1_1, lc-state=valid, period-begin=ar-release-version=4.4.0
      lc-object=M1AmntNeg1, lc-state=valid, period-begin=ar-release-version=4.4.0
      lc-object=M1, lc-state=valid, period-begin=ar-release-version=4.4.0
      lc-object=Len1TiNeg3, lc-state=valid, period-begin=ar-release-version=4.4.0
      lc-object=Len1TiNeg2, lc-state=valid, period-begin=ar-release-version=4.4.0
      lc-object=Len1TiNeg1, lc-state=valid, period-begin=ar-release-version=4.4.0
      lc-object=Len1, lc-state=valid, period-begin=ar-release-version=4.4.0
      lc-object=Len1M1TiNeg3INeg1, lc-state=valid, period-begin=ar-release-version=4.4.0
      lc-object=Len1M1TiNeg3TNeg1, lc-state=valid, period-begin=ar-release-version=4.4.0
      lc-object=Len1M1TiNeg2INeg2, lc-state=valid, period-begin=ar-release-version=4.4.0
      lc-object=Len1M1TiNeg2, lc-state=valid, period-begin=ar-release-version=4.4.0
      lc-object=Len1M1TiNeg2_1, lc-state=valid, period-begin=ar-release-version=4.4.0
      lc-object=Len2TiNeg2TNeg1, lc-state=valid, period-begin=ar-release-version=4.4.0
      lc-object=Len2TiNeg2, lc-state=valid, period-begin=ar-release-version=4.4.0
      lc-object=Len2Ti1, lc-state=valid, period-begin=ar-release-version=4.4.0
      lc-object=Len2, lc-state=valid, period-begin=ar-release-version=4.4.0
      lc-object=Len2_1, lc-state=valid, period-begin=ar-release-version=4.4.0
      lc-object=Len2M1TiNeg4INeg1, lc-state=valid, period-begin=ar-release-version=4.4.0
      lc-object=Len2M1TiNeg4, lc-state=valid, period-begin=ar-release-version=4.4.0
      lc-object=Len2M1TiNeg3INeg2, lc-state=valid, period-begin=ar-release-version=4.4.0
      lc-object=Len2M1TiNeg3INeg1, lc-state=valid, period-begin=ar-release-version=4.4.0
      lc-object=Len2M1TiNeg3, lc-state=valid, period-begin=ar-release-version=4.4.0
      lc-object=Len2M1TiNeg3_1, lc-state=valid, period-begin=ar-release-version=4.4.0
      lc-object=Len2M1TiNeg2INeg2, lc-state=valid, period-begin=ar-release-version=4.4.0
      lc-object=Len2M1TiNeg2INeg1, lc-state=valid, period-begin=ar-release-version=4.4.0
      lc-object=Len2M1TiNeg2TNeg1AmntNeg1, lc-state=valid, period-begin=ar-release-version=4.4.0
      lc-object=Len2M1TiNeg2TNeg1, lc-state=valid, period-begin=ar-release-version=4.4.0
      lc-object=Len2M1TiNeg2AmntNeg1, lc-state=valid, period-begin=ar-release-version=4.4.0
      lc-object=Len2M1TiNeg2, lc-state=valid, period-begin=ar-release-version=4.4.0
      lc-object=Len2M1TiNeg2_1, lc-state=valid, period-begin=ar-release-version=4.4.0
      lc-object=Len2M1TiNeg1, lc-state=valid, period-begin=ar-release-version=4.4.0
      lc-object=Len2M1, lc-state=valid, period-begin=ar-release-version=4.4.0
      lc-object=Len3MNeg1, lc-state=valid, period-begin=ar-release-version=4.4.0
      lc-object=Len3TiNeg2, lc-state=valid, period-begin=ar-release-version=4.4.0
      lc-object=Len3TiNeg1, lc-state=valid, period-begin=ar-release-version=4.4.0
      lc-object=Len3, lc-state=valid, period-begin=ar-release-version=4.4.0
      lc-object=Amnt1, lc-state=obsolete, period-begin=ar-release-version=4.4.0, use-instead=Amnt1
      lc-object=I1, lc-state=obsolete, period-begin=ar-release-version=4.4.0, use-instead=I1
      lc-object=Illmn1, lc-state=obsolete, period-begin=ar-release-version=4.4.0, use-instead=Illmn1
      lc-object=Len1, lc-state=obsolete, period-begin=ar-release-version=4.4.0, use-instead=Len1
      lc-object=Len1M1TiNeg2, lc-state=obsolete, period-begin=ar-release-version=4.4.0, use-instead=Len1M1TiNeg2
      lc-object=Len1TiNeg{1..3}, lc-state=obsolete, period-begin=ar-release-version=4.4.0, use-instead=Len1TiNeg{1..3}
      lc-object=Len2M1TiNeg2, lc-state=obsolete, period-begin=ar-release-version=4.4.0, use-instead=Len2M1TiNeg2
      lc-object=Len2M1TiNeg3, lc-state=obsolete, period-begin=ar-release-version=4.4.0, use-instead=Len2M1TiNeg3
      lc-object=Len2M1TiNeg3INeg1, lc-state=obsolete, period-begin=ar-release-version=4.4.0, use-instead=Len2M1TiNeg3INeg1
      lc-object=LenNeg1, lc-state=obsolete, period-begin=ar-release-version=4.4.0, use-instead=LenNeg1
      lc-object=LenNeg1M1TiNeg2, lc-state=obsolete, period-begin=ar-release-version=4.4.0, use-instead=LenNeg1M1TiNeg2
      lc-object=M1, lc-state=obsolete, period-begin=ar-release-version=4.4.0, use-instead=M1
      lc-object=M1TiNeg1, lc-state=obsolete, period-begin=ar-release-version=4.4.0, use-instead=M1TiNeg1
      lc-object=M1TiNeg2, lc-state=obsolete, period-begin=ar-release-version=4.4.0, use-instead=M1TiNeg2
      lc-object=NoDimension, lc-state=obsolete, period-begin=ar-release-version=4.4.0, use-instead=NoDimension
      lc-object=NoDimension_1, lc-state=obsolete, period-begin=ar-release-version=4.4.0, use-instead=NoDimension_1
      lc-object=NoDimension_2, lc-state=obsolete, period-begin=ar-release-version=4.4.0, use-instead=NoDimension_2
      lc-object=T1, lc-state=obsolete, period-begin=ar-release-version=4.4.0, use-instead=T1
      lc-object=T1_1, lc-state=obsolete, period-begin=ar-release-version=4.4.0, use-instead=T1_1
      lc-object=T1_2, lc-state=obsolete, period-begin=ar-release-version=4.4.0
      lc-object=Ti1, lc-state=obsolete, period-begin=ar-release-version=4.4.0, use-instead=Ti1
      lc-object=TiNeg1, lc-state=obsolete, period-begin=ar-release-version=4.4.0, use-instead=TiNeg1
      lc-object=TiNeg1_1, lc-state=obsolete, period-begin=ar-release-version=4.4.0, use-instead=TiNeg1_1
      lc-object=TiNeg1_2, lc-state=obsolete, period-begin=ar-release-version=4.4.0, use-instead=TiNeg1_2
      lc-object=TiNeg2, lc-state=obsolete, period-begin=ar-release-version=4.4.0, use-instead=TiNeg2
