AUTOSAR XML (schema 00050)
package /AUTOSAR/AISpecification/LifeCycleInfoSets
  life cycle info set CompuMethodObslt: default-lc-state=obsolete, used-life-cycle-state-definition-group=AutosarLifeCycleStates
    life-cycle-infos:
      lc-object=AckSts1, period-begin=ar-release-version=4.2.1, remark=p=l-1=Change of shortname, use-instead=AckSt1
      lc-object=AlrmSts1, period-begin=ar-release-version=4.2.1, remark=p=l-1=Change of shortname, use-instead=AlrmSt1
      lc-object=AvlSts1, period-begin=ar-release-version=4.2.1, remark=p=l-1=Change of shortname, use-instead=AvlSt1
      lc-object=CalSts1, period-begin=ar-release-version=4.2.1, remark=p=l-1=Change of shortname, use-instead=CalSt1
      lc-object=CrashSts1, period-begin=ar-release-version=4.2.1, remark=p=l-1=Change of shortname, use-instead=CrashSt1
      lc-object=CrsCtrlAndAccSwtSts1, period-begin=ar-release-version=4.2.1, remark=p=l-1=Change of shortname, use-instead=CrsCtrlAndAccSwtSt1
      lc-object=CtrlSts1, period-begin=ar-release-version=4.2.1, remark=p=l-1=Change of shortname, use-instead=CtrlSt1
      lc-object=DetnSts1, period-begin=ar-release-version=4.2.1, remark=p=l-1=Change of shortname, use-instead=DetnSt1
      lc-object=DevErrSts{1..4}, period-begin=ar-release-version=4.2.1, remark=p=l-1=Change of shortname, use-instead=DevErrSt{1..4}
      lc-object=DevSts{4..7}, period-begin=ar-release-version=4.2.1, remark=p=l-1=Change of shortname, use-instead=DevSt{4..7}
      lc-object=DoorHndlSts1, period-begin=ar-release-version=4.2.1, remark=p=l-1=Change of shortname, use-instead=DoorHndlSt1
      lc-object=DoorSts1, period-begin=ar-release-version=4.2.1, remark=p=l-1=Change of shortname, use-instead=DoorSt1
      lc-object=EgyMngtSts1, period-begin=ar-release-version=4.2.1, remark=p=l-1=Change of shortname, use-instead=EgyMngtSt1
      lc-object=EpbBtnCtrlSts1, period-begin=ar-release-version=4.2.1, remark=p=l-1=Change of shortname, use-instead=EpbBtnCtrlSt1
      lc-object=ImobSts1, period-begin=ar-release-version=4.2.1, remark=p=l-1=Change of shortname, use-instead=ImobSt1
      lc-object=ImpctSts1, period-begin=ar-release-version=4.2.1, remark=p=l-1=Change of shortname, use-instead=ImpctSt1
      lc-object=IndcrSts1, period-begin=ar-release-version=4.2.1, remark=p=l-1=Change of shortname, use-instead=IndcrSt1
      lc-object=KeyInsertSts1, period-begin=ar-release-version=4.2.1, remark=p=l-1=Change of shortname, use-instead=KeyInsertSt1
      lc-object=KeySts1, period-begin=ar-release-version=4.2.1, remark=p=l-1=Change of shortname, use-instead=KeySt1
      lc-object=LockSts1, period-begin=ar-release-version=4.2.1, remark=p=l-1=Change of shortname, use-instead=LockSt1
      lc-object=LockSts2, period-begin=ar-release-version=4.2.1, remark=p=l-1=Change of shortname, use-instead=LockSt2
      lc-object=LockStsOfSteerCol1, period-begin=ar-release-version=4.2.1, remark=p=l-1=Change of shortname, use-instead=LockStOfSteerCol1
      lc-object=MoveSts1, period-begin=ar-release-version=4.2.1, remark=p=l-1=Change of shortname, use-instead=MoveSt1
      lc-object=ObstclDstInPrkgSegSts1, period-begin=ar-release-version=4.2.1, remark=p=l-1=Change of shortname, use-instead=ObstclDstInPrkgSegSt1
      lc-object=OperModSts1, period-begin=ar-release-version=4.2.1, remark=p=l-1=Change of shortname, use-instead=OperModSt1
      lc-object=OutdBriSts1, period-begin=ar-release-version=4.2.1, remark=p=l-1=Change of shortname, use-instead=OutdBriSt1
      lc-object=OvrdnSts1, period-begin=ar-release-version=4.2.1, remark=p=l-1=Change of shortname, use-instead=OvrdnSt1
      lc-object=ProfPenSts1, period-begin=ar-release-version=4.2.1, remark=p=l-1=Change of shortname, use-instead=ProfPenSt1
      lc-object=ReqSts1, period-begin=ar-release-version=4.2.1, remark=p=l-1=Change of shortname, use-instead=ReqSt1
      lc-object=ReqSts2, period-begin=ar-release-version=4.2.1, remark=p=l-1=Change of shortname, use-instead=ReqSt2
      lc-object=RoadSts1, period-begin=ar-release-version=4.2.1, remark=p=l-1=Change of shortname, use-instead=RoadSt1
      lc-object=StabrSts1, period-begin=ar-release-version=4.2.1, remark=p=l-1=Change of shortname, use-instead=StabrSt1
      lc-object=StsOfObjMeasd1, period-begin=ar-release-version=4.2.1, remark=p=l-1=Change of shortname, use-instead=StOfObjMeasd1
      lc-object=TSts1, period-begin=ar-release-version=4.2.1, remark=p=l-1=Change of shortname, use-instead=TSt1
      lc-object=TirePMonWarnSts{1..3}, period-begin=ar-release-version=4.2.1, remark=p=l-1=Change of shortname, use-instead=TirePMonWarnSt{1..3}
      lc-object=A8, period-begin=ar-release-version=4.1.1, remark=p=l-1=changed specification, use-instead=A13
      lc-object=A9, period-begin=ar-release-version=4.1.1, remark=p=l-1=changed specification, use-instead=A14
      lc-object=WhlRotlDirStd1, lc-state=obsolete, period-begin=ar-release-version=4.2.1, use-instead=WhlRotlDirMeasd1
      lc-object=BarIdentcl, lc-state=valid, period-begin=ar-release-version=4.2.2
      lc-object=DegCgrdIdentcl, lc-state=valid, period-begin=ar-release-version=4.2.2
      lc-object=HectoPaIdentcl, lc-state=valid, period-begin=ar-release-version=4.2.2
      lc-object=HzIdentcl, lc-state=valid, period-begin=ar-release-version=4.2.2
      lc-object=KiloGrIdentcl, lc-state=valid, period-begin=ar-release-version=4.2.2
      lc-object=KiloHzIdentcl, lc-state=valid, period-begin=ar-release-version=4.2.2
      lc-object=KiloMtrIdentcl, lc-state=valid, period-begin=ar-release-version=4.2.2
      lc-object=MtrIdentcl, lc-state=valid, period-begin=ar-release-version=4.2.2
      lc-object=MtrPerSecIdentcl, lc-state=valid, period-begin=ar-release-version=4.2.2
      lc-object=MtrPerSecCubdIdentcl, lc-state=valid, period-begin=ar-release-version=4.2.2
      lc-object=MtrPerSecSqdIdentcl, lc-state=valid, period-begin=ar-release-version=4.2.2
      lc-object=MtrRecprIdentcl, lc-state=valid, period-begin=ar-release-version=4.2.2
      lc-object=NoUnitIdentcl, lc-state=valid, period-begin=ar-release-version=4.2.2
      lc-object=NwtIdentcl, lc-state=valid, period-begin=ar-release-version=4.2.2
      lc-object=NwtMtrIdentcl, lc-state=valid, period-begin=ar-release-version=4.2.2
      lc-object=NwtMtrPerSecIdentcl, lc-state=valid, period-begin=ar-release-version=4.2.2
      lc-object=NwtPerMtrIdentcl, lc-state=valid, period-begin=ar-release-version=4.2.2
      lc-object=NwtSecPerMtrIdentcl, lc-state=valid, period-begin=ar-release-version=4.2.2
      lc-object=PercPerSecIdentcl, lc-state=valid, period-begin=ar-release-version=4.2.2
      lc-object=RadIdentcl, lc-state=valid, period-begin=ar-release-version=4.2.2
      lc-object=RadPerSecIdentcl, lc-state=valid, period-begin=ar-release-version=4.2.2
      lc-object=RadPerSecSqdIdentcl, lc-state=valid, period-begin=ar-release-version=4.2.2
      lc-object=RpmIdentcl, lc-state=valid, period-begin=ar-release-version=4.2.2
      lc-object=RpmPerSecIdentcl, lc-state=valid, period-begin=ar-release-version=4.2.2
      lc-object=SecIdentcl, lc-state=valid, period-begin=ar-release-version=4.2.2
      lc-object=VoltIdentcl, lc-state=valid, period-begin=ar-release-version=4.2.2
      lc-object=PtTqCluMaxFastIntvModTyp1, lc-state=valid, period-begin=ar-release-version=4.2.2
      lc-object=TrsmTqReqMaxMinTyp1, lc-state=valid, period-begin=ar-release-version=4.2.2
      lc-object=PtIntvModTqCluFastReqTyp1, lc-state=valid, period-begin=ar-release-version=4.3.0
      lc-object=PtTqCluMaxFastIntvModTyp1, lc-state=obsolete, period-begin=ar-release-version=4.3.0, use-instead=PtIntvModTqCluFastReqTyp1
      lc-object=TrsmTqReqTyp2, lc-state=valid, period-begin=ar-release-version=4.3.0
      lc-object=TrsmTqReqTyp2, lc-state=valid, period-begin=ar-release-version=4.3.0
      lc-object=TrsmTqReqTyp1, lc-state=obsolete, period-begin=ar-release-version=4.3.0, use-instead=TrsmTqReqTyp2
      lc-object=EngRunngDir2, lc-state=valid, period-begin=ar-release-version=4.3.0
      lc-object=Tq16, lc-state=obsolete, period-begin=ar-release-version=4.3.0, use-instead=Tq5
      lc-object=DegCgrdLnr1, lc-state=valid, period-begin=ar-release-version=4.3.0
      lc-object=DegCgrdLnr1, lc-state=valid, period-begin=ar-release-version=4.3.0
      lc-object=RpmLnr1, lc-state=valid, period-begin=ar-release-version=4.3.0
      lc-object=RpmLnr1, lc-state=valid, period-begin=ar-release-version=4.3.0
      lc-object=TrsmPwrSt1, lc-state=valid, period-begin=ar-release-version=4.3.1
      lc-object=TrsmPwrSt1, lc-state=valid, period-begin=ar-release-version=4.3.1
      lc-object=EnagSt1, lc-state=valid, period-begin=ar-release-version=4.3.1
      lc-object=EnagSt1, lc-state=valid, period-begin=ar-release-version=4.3.1
      lc-object=GearSt1, lc-state=valid, period-begin=ar-release-version=4.3.1
      lc-object=GearSt1, lc-state=valid, period-begin=ar-release-version=4.3.1
      lc-object=TrsmPwrStCtrl1, lc-state=valid, period-begin=ar-release-version=4.5.0
      lc-object=Tq5, lc-state=valid, period-begin=ar-release-version=4.3.1
      lc-object=TrsmIntvModReqForTqCluReqForShiftIntvTyp1, lc-state=valid, period-begin=ar-release-version=4.5.0
      lc-object=PtIntvModTqCluFastReqTyp1, lc-state=obsolete, period-begin=ar-release-version=4.5.0, use-instead=TrsmIntvModReqForTqCluReqForShiftIntvTyp1
      lc-object=EngRunngDir1, lc-state=valid, period-begin=ar-release-version=4.3.1
